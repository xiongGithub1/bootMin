/*@!Encoding:1252*/
/**
 * Boot_FlashPanel.can
 * ------------------------------------------------------------------
 * CANoe CAPL test module: UDS flash APP from Intel HEX via a panel.
 *
 * Files in this folder:
 *   Boot_FlashPanel.vsysvar  system variables (namespace BootFlash)
 *   Boot_FlashPanel.xvp      panel (re-bind symbols if CANoe version differs)
 *   Boot_FlashPanel.can      this CAPL
 *
 * CANoe 12 setup:
 *   1. CAN 500 kbit/s, ECU on the bus. Set cCanCh to your CANoe channel
 *      (Write window showed CAN 3 in this project).
 *   2. Environment -> System Variables -> Import Boot_FlashPanel.vsysvar
 *   3. Panels -> Add -> Boot_FlashPanel.xvp
 *      If the panel is empty/unbound: Panel Designer, bind controls to
 *      BootFlash::FilePath / Start / Abort / DoReset / Progress / Status /
 *      Busy / BytesSent / BytesTotal / LogEnable / LogPath / LogUseDefault /
 *      LogRecording (see vsysvar).
 *   4. Test Setup -> CAPL Test Module -> this file. F7, then Start.
 *      Also assign the Test Module to the same CAN bus/channel as cCanCh.
 *   5. HEX path: edit cHexDefault in this file, or type/bind FilePath on the panel.
 *      Panel Designer toolbox has "Path Dialog" -- bind it to BootFlash::FilePath
 *      (filter *.hex) for a Windows file picker. Click Browse to copy cHexDefault.
 *   6. Frame log: check LogEnable; set LogPath to a folder (trailing \) or full .txt.
 *      LogUseDefault copies cLogDirDefault. One file per Start Flash session.
 *
 * Sequence: 10 02 -> 27 L1 (~seed) -> 31 01 FF00 -> 34 -> 36.. -> 37
 *           -> 31 FF02 + CRC32 BE -> 31 FF01 -> optional 11 01
 * APP window 0x80020000..0x801FFFFF, 32-byte align, DLC 8.
 * HEX records must be address-sorted (Tasking default). Holes padded 0x00.
 * Host stream CRC (IEEE/AUTOSAR CRC32) must match ECU Boot_LastCrc on FF02.
 * This is a flasher, not the E-group protocol test.
 */

includes
{
}

variables
{
  const dword cReqId  = 0x74C;
  const dword cRespId = 0x75C;

  /* CANoe bus number (Measurement Setup / Hardware: your ECU is on CAN 3). */
  const int   cCanCh  = 3;

  const dword cAppStart = 0x80020000;
  const dword cAppEnd   = 0x801FFFFF;
  const dword cChunk    = 480;  /* 32-byte aligned; <= BOOT_UDS_MAX_BLOCK_LENGTH-2 */
  const dword cSector   = 0x4000;   /* TC3xx PFlash logical sector */
  /* Erase this many sectors per 31 FF00 so Progress can move (full APP = ~120). */
  const dword cEraseChunkSectors = 2;

  /* Default APP Intel HEX. Used when BootFlash::FilePath is empty.
   * Edit this line, or put a Path Dialog on the panel bound to FilePath. */
  char cHexDefault[260] = "F:\\workFiles\\TC367\\TC367\\workspace\\last364\\Debug\\last364.hex";

  /* Default folder for flash TX/RX logs (trailing backslash). */
  char cLogDirDefault[260] = "F:\\workFiles\\TC367\\TC367\\workspace\\autosarTc364_Boot (2)\\Test\\FlashPanel\\logs\\";

  message 0x000 gReq;
  message 0x000 gFrame;
  byte     gResp[512];

  byte gQData[32];
  byte gQDlc[4];
  int  gQRd;
  int  gQWr;
  int  gQCnt;

  byte gTd[512];
  byte gChunk[480];
  dword gChunkLen;
  dword gEmit;
  byte  gBsc;
  dword gStart;
  dword gSize;
  dword gMinA;
  dword gMaxA;
  dword gLastA;
  int   gSaw;
  dword gStreamCrc;   /* host CRC of bytes sent in 0x36 (matches Boot_LastCrc) */
  int   gStreamCrcOn; /* 0 = next feed is first call */

  dword gLogFh;       /* 0 = not logging */
  char  gLogFile[300];
}

/* =====================================================================
 * System variables (namespace BootFlash)
 * Import Boot_FlashPanel.vsysvar (Progress/Status/Busy must NOT be read-only).
 * Do NOT sysDefineVariable* — that duplicates names; panel stays at 0.
 * CAPL: no strcmp; @sysvar cannot assign string / read-only ints.
 * ===================================================================== */

int GetI(char n[])
{
  return sysGetVariableInt("BootFlash", n);
}

void SetI(char n[], long v)
{
  sysSetVariableInt("BootFlash", n, v);
}

void SetS(char n[], char s[])
{
  sysSetVariableString("BootFlash", n, s);
}

void SetProgress(long pct, char msg[])
{
  if (pct < 0) { pct = 0; }
  if (pct > 100) { pct = 100; }
  sysSetVariableInt("BootFlash", "Progress", pct);
  sysSetVariableString("BootFlash", "Status", msg);
  write("[%d%%] %s", pct, msg);
}

void GetPath(char s[])
{
  sysGetVariableString("BootFlash", "FilePath", s, 260);
}

void CopyDefaultPath(char path[])
{
  dword i;

  for (i = 0; i < 259; i++)
  {
    path[i] = cHexDefault[i];
    if (cHexDefault[i] == 0)
    {
      break;
    }
  }
  path[259] = 0;
}

void ApplyDefaultPath(void)
{
  char path[260];

  CopyDefaultPath(path);
  SetS("FilePath", path);
  write("HEX path (script): %s", path);
}

void ResolvePath(char path[])
{
  GetPath(path);
  if (strlen(path) >= 4)
  {
    return;
  }
  CopyDefaultPath(path);
  SetS("FilePath", path);
}

void GetLogPathCfg(char s[])
{
  sysGetVariableString("BootFlash", "LogPath", s, 260);
}

void CopyDefaultLogDir(char path[])
{
  dword i;

  for (i = 0; i < 259; i++)
  {
    path[i] = cLogDirDefault[i];
    if (cLogDirDefault[i] == 0)
    {
      break;
    }
  }
  path[259] = 0;
}

void ApplyDefaultLogPath(void)
{
  char path[260];

  CopyDefaultLogDir(path);
  SetS("LogPath", path);
  write("Log dir (script): %s", path);
}

void LogClose(void)
{
  char endMsg[24];

  if (gLogFh != 0)
  {
    endMsg[0] = '-'; endMsg[1] = '-'; endMsg[2] = '-';
    endMsg[3] = ' '; endMsg[4] = 'e'; endMsg[5] = 'n';
    endMsg[6] = 'd'; endMsg[7] = ' '; endMsg[8] = '-';
    endMsg[9] = '-'; endMsg[10] = '-'; endMsg[11] = '\n';
    endMsg[12] = 0;
    filePutString(endMsg, elcount(endMsg), gLogFh);
    fileClose(gLogFh);
    write("Flash log closed: %s", gLogFile);
    gLogFh = 0;
  }
  SetI("LogRecording", 0);
}

void LogLine(char s[])
{
  char line[360];

  if (gLogFh == 0)
  {
    return;
  }
  snprintf(line, elcount(line), "t=%d %s\n", timeNow(), s);
  filePutString(line, elcount(line), gLogFh);
}

void LogCan(char dir[], dword id, byte d[], dword n)
{
  char line[120];
  dword i;

  if (gLogFh == 0)
  {
    return;
  }
  snprintf(line, elcount(line), "t=%d %s ID=%03X", timeNow(), dir, id);
  filePutString(line, elcount(line), gLogFh);
  for (i = 0; (i < n) && (i < 8); i++)
  {
    snprintf(line, elcount(line), " %02X", d[i]);
    filePutString(line, elcount(line), gLogFh);
  }
  line[0] = '\n';
  line[1] = 0;
  filePutString(line, elcount(line), gLogFh);
}

void LogUds(char dir[], byte data[], dword len)
{
  char line[80];
  dword i;
  dword n;

  if (gLogFh == 0)
  {
    return;
  }
  n = len;
  if (n > 64)
  {
    n = 64;
  }
  snprintf(line, elcount(line), "t=%d UDS-%s len=%d", timeNow(), dir, len);
  filePutString(line, elcount(line), gLogFh);
  for (i = 0; i < n; i++)
  {
    snprintf(line, elcount(line), " %02X", data[i]);
    filePutString(line, elcount(line), gLogFh);
  }
  if (len > n)
  {
    snprintf(line, elcount(line), " ...(+%d)", len - n);
    filePutString(line, elcount(line), gLogFh);
  }
  line[0] = '\n';
  line[1] = 0;
  filePutString(line, elcount(line), gLogFh);
}

int LogPathIsFolder(char path[])
{
  dword n;

  n = strlen(path);
  if (n == 0)
  {
    return 1;
  }
  if ((path[n - 1] == '\\') || (path[n - 1] == '/'))
  {
    return 1;
  }
  return 0;
}

/* Split full file path into dir (for setWritePath) + file name. */
void LogSplitPath(char full[], char dirOut[], char nameOut[])
{
  dword i;
  dword n;
  dword last;

  n = strlen(full);
  last = 0;
  for (i = 0; i < n; i++)
  {
    if ((full[i] == '\\') || (full[i] == '/'))
    {
      last = i;
    }
  }
  if (last == 0)
  {
    dirOut[0] = '.';
    dirOut[1] = 0;
    for (i = 0; i < n && i < 259; i++)
    {
      nameOut[i] = full[i];
    }
    nameOut[i] = 0;
    return;
  }
  for (i = 0; i <= last && i < 259; i++)
  {
    dirOut[i] = full[i];
  }
  dirOut[i] = 0;
  for (i = 0; (last + 1 + i) < n && i < 259; i++)
  {
    nameOut[i] = full[last + 1 + i];
  }
  nameOut[i] = 0;
}

int LogOpen(void)
{
  char cfg[260];
  char dir[260];
  char name[80];
  long t[9];
  dword i;
  dword n;

  LogClose();
  GetLogPathCfg(cfg);
  if (strlen(cfg) < 2)
  {
    CopyDefaultLogDir(cfg);
    SetS("LogPath", cfg);
  }

  getLocalTime(t);
  if (LogPathIsFolder(cfg) != 0)
  {
    /* t[0]=year [1]=mon [2]=day [4]=hour [5]=min [6]=sec */
    for (i = 0; i < 259; i++)
    {
      dir[i] = cfg[i];
      if (cfg[i] == 0)
      {
        break;
      }
    }
    dir[259] = 0;
    snprintf(name, elcount(name),
             "FlashLog_%04d%02d%02d_%02d%02d%02d.txt",
             t[0], t[1], t[2], t[4], t[5], t[6]);
    snprintf(gLogFile, elcount(gLogFile), "%s%s", dir, name);
  }
  else
  {
    LogSplitPath(cfg, dir, name);
    n = strlen(cfg);
    if (n >= elcount(gLogFile))
    {
      n = elcount(gLogFile) - 1;
    }
    for (i = 0; i < n; i++)
    {
      gLogFile[i] = cfg[i];
    }
    gLogFile[n] = 0;
  }

  /* CAPL: openFileWrite uses setWritePath + relative name. */
  setWritePath(dir);
  gLogFh = openFileWrite(name, 0);
  if (gLogFh == 0)
  {
    write("cannot open log: %s (create folder?)", gLogFile);
    SetS("Status", "log open failed");
    return 0;
  }
  SetI("LogRecording", 1);
  snprintf(cfg, elcount(cfg), "log open %s", gLogFile);
  LogLine(cfg);
  write("Flash log: %s", gLogFile);
  return 1;
}

void InitSys(void)
{
  /* Use imported .vsysvar only — never sysDefineVariable here. */
  gLogFh = 0;
  gLogFile[0] = 0;
}

void Fail(char msg[])
{
  SetS("Status", msg);
  write("Flash FAIL: %s", msg);
  LogClose();
  SetI("Busy", 0);
}

/* =====================================================================
 * ISO-TP (same rules as Boot_Dcm_CanoeTest.can: DLC=8, RX queue)
 * ===================================================================== */

on message 0x75C
{
  dword i;
  dword base;

  if (this.can != cCanCh)
  {
    return;
  }
  if (gQCnt >= 4)
  {
    return;
  }
  base = gQWr * 8;
  gQDlc[gQWr] = this.dlc;
  for (i = 0; i < 8; i++)
  {
    gQData[base + i] = this.byte(i);
  }
  gQWr = (gQWr + 1) % 4;
  gQCnt = gQCnt + 1;
}

void RxDrain(void)
{
  gQRd = 0;
  gQWr = 0;
  gQCnt = 0;
}

int RxPop(void)
{
  dword i;
  dword base;
  byte rxb[8];

  if (gQCnt <= 0)
  {
    return 0;
  }
  base = gQRd * 8;
  gFrame.id = cRespId;
  gFrame.dlc = gQDlc[gQRd];
  for (i = 0; i < 8; i++)
  {
    gFrame.byte(i) = gQData[base + i];
    rxb[i] = gQData[base + i];
  }
  gQRd = (gQRd + 1) % 4;
  gQCnt = gQCnt - 1;
  LogCan("RX", cRespId, rxb, 8);
  return 1;
}

void SendRaw(dword txId, byte frame[], dword len)
{
  dword i;

  if (len > 8)
  {
    len = 8;
  }
  LogCan("TX", txId, frame, len);
  gReq.id = txId;
  gReq.can = cCanCh;
  gReq.dlc = 8;
  for (i = 0; i < len; i++)
  {
    gReq.byte(i) = frame[i];
  }
  for (; i < 8; i++)
  {
    gReq.byte(i) = 0x00;
  }
  output(gReq);
}

int WaitRaw(dword timeout)
{
  dword waited;

  waited = 0;
  while (waited < timeout)
  {
    if (RxPop() != 0)
    {
      return 1;
    }
    TestWaitForTimeout(1);
    waited += 1;
  }
  return RxPop();
}

int WaitRawPci(dword timeout, byte pciHi)
{
  dword waited;

  waited = 0;
  while (waited < timeout)
  {
    if (WaitRaw(50) == 0)
    {
      waited += 50;
    }
    else if ((gFrame.byte(0) & 0xF0) == pciHi)
    {
      return 1;
    }
    else
    {
      waited += 1;
    }
  }
  return 0;
}

void SendTp(byte data[], dword len, dword txId)
{
  dword i;
  dword off;
  dword seq;
  dword n;
  dword bs;
  dword stmin;
  dword sent;
  byte  frame[8];

  if (len <= 7)
  {
    frame[0] = len;
    for (i = 0; i < len; i++)
    {
      frame[1 + i] = data[i];
    }
    SendRaw(txId, frame, 1 + len);
    return;
  }

  frame[0] = 0x10 | ((len >> 8) & 0x0F);
  frame[1] = len & 0xFF;
  for (i = 0; i < 6; i++)
  {
    if (i < len)
    {
      frame[2 + i] = data[i];
    }
    else
    {
      frame[2 + i] = 0;
    }
  }
  SendRaw(txId, frame, 8);

  if (WaitRawPci(1000, 0x30) == 0)
  {
    write("ISO-TP: no flow control");
    return;
  }

  bs    = gFrame.byte(1);
  stmin = gFrame.byte(2) & 0x7F;
  off   = 6;
  seq   = 1;
  sent  = 0;

  while (off < len)
  {
    if ((bs > 0) && (sent > 0) && ((sent % bs) == 0))
    {
      if (WaitRawPci(1000, 0x30) == 0)
      {
        write("ISO-TP: no further FC");
        return;
      }
      stmin = gFrame.byte(2) & 0x7F;
    }

    n = len - off;
    if (n > 7)
    {
      n = 7;
    }
    frame[0] = 0x20 | (seq & 0x0F);
    for (i = 0; i < n; i++)
    {
      frame[1 + i] = data[off + i];
    }
    SendRaw(txId, frame, 1 + n);

    if (stmin > 0)
    {
      /* +2 ms: TestWaitForTimeout is coarse; avoids STmin-receive violated spam. */
      TestWaitForTimeout(stmin + 2);
    }
    else
    {
      TestWaitForTimeout(1);
    }

    off  += n;
    seq  += 1;
    sent += 1;
  }
}

dword WaitTp(byte resp[], dword timeout)
{
  dword total;
  dword off;
  dword i;
  dword waited;
  byte  pci;
  byte  fc[3];

  waited = 0;
  pci = 0xFF;
  while (waited < timeout)
  {
    if (WaitRaw(50) == 0)
    {
      waited += 50;
    }
    else
    {
      pci = gFrame.byte(0) & 0xF0;
      if ((pci == 0x00) || (pci == 0x10))
      {
        break;
      }
      waited += 1;
      pci = 0xFF;
    }
  }
  if ((pci != 0x00) && (pci != 0x10))
  {
    return 0;
  }

  if ((gFrame.byte(0) & 0xF0) == 0x00)
  {
    total = gFrame.byte(0) & 0x0F;
    for (i = 0; i < total; i++)
    {
      resp[i] = gFrame.byte(1 + i);
    }
    return total;
  }

  if ((gFrame.byte(0) & 0xF0) == 0x10)
  {
    total = ((gFrame.byte(0) & 0x0F) << 8) | gFrame.byte(1);
    off = 0;
    for (i = 2; (i < 8) && (off < total); i++)
    {
      resp[off] = gFrame.byte(i);
      off++;
    }
    fc[0] = 0x30;
    fc[1] = 0x00;
    fc[2] = 0x00;
    SendRaw(cReqId, fc, 3);

    while (off < total)
    {
      if (WaitRaw(timeout) == 0)
      {
        return 0;
      }
      if ((gFrame.byte(0) & 0xF0) == 0x20)
      {
        for (i = 1; (i < 8) && (off < total); i++)
        {
          resp[off] = gFrame.byte(i);
          off++;
        }
      }
    }
    return total;
  }

  return 0;
}

dword UdsRequest(byte req[], dword reqLen, byte resp[], dword timeout, dword txId)
{
  dword n;

  TestWaitForTimeout(20);
  RxDrain();
  LogUds("TX", req, reqLen);
  SendTp(req, reqLen, txId);
  n = WaitTp(resp, timeout);
  if (n > 0)
  {
    LogUds("RX", resp, n);
  }
  else
  {
    LogLine("UDS-RX timeout");
  }
  return n;
}

/* =====================================================================
 * HEX
 * ===================================================================== */

int HexNib(char c)
{
  if ((c >= '0') && (c <= '9')) { return c - 0x30; }
  if ((c >= 'A') && (c <= 'F')) { return c - 0x37; }
  if ((c >= 'a') && (c <= 'f')) { return c - 0x57; }
  return -1;
}

int HexByte(char s[], dword p)
{
  int hi;
  int lo;

  hi = HexNib(s[p]);
  lo = HexNib(s[p + 1]);
  if ((hi < 0) || (lo < 0))
  {
    return -1;
  }
  return (hi << 4) | lo;
}

int InApp(dword a)
{
  if (a < cAppStart) { return 0; }
  if (a > cAppEnd)   { return 0; }
  return 1;
}

int ScanHex(char path[])
{
  dword fh;
  char line[600];
  dword base;
  dword nn;
  dword offs;
  dword typ;
  dword i;
  dword absA;
  int nni;
  int ahi;
  int alo;
  int tpi;
  int b0;
  int b1;
  int v;

  fh = openFileRead(path, 0);
  if (fh == 0)
  {
    Fail("cannot open HEX");
    return 0;
  }

  base = 0;
  gMinA = 0xFFFFFFFF;
  gMaxA = 0;
  gLastA = 0;
  gSaw = 0;

  while (fileGetString(line, elcount(line), fh) != 0)
  {
    if (line[0] != ':')
    {
      continue;
    }
    nni = HexByte(line, 1);
    ahi = HexByte(line, 3);
    alo = HexByte(line, 5);
    tpi = HexByte(line, 7);
    if ((nni < 0) || (ahi < 0) || (alo < 0) || (tpi < 0))
    {
      fileClose(fh);
      Fail("HEX parse error");
      return 0;
    }
    nn = nni;
    offs = ((dword)ahi << 8) | (dword)alo;
    typ = tpi;

    if (typ == 1)
    {
      break;
    }
    else if (typ == 4)
    {
      b0 = HexByte(line, 9);
      b1 = HexByte(line, 11);
      base = (((dword)b0 << 8) | (dword)b1) << 16;
    }
    else if (typ == 2)
    {
      b0 = HexByte(line, 9);
      b1 = HexByte(line, 11);
      base = (((dword)b0 << 8) | (dword)b1) << 4;
    }
    else if (typ == 0)
    {
      for (i = 0; i < nn; i++)
      {
        v = HexByte(line, 9 + (i * 2));
        if (v < 0)
        {
          fileClose(fh);
          Fail("HEX data error");
          return 0;
        }
        absA = base + offs + i;
        if (InApp(absA) == 0)
        {
          continue;
        }
        if ((gSaw != 0) && (absA < gLastA))
        {
          fileClose(fh);
          Fail("HEX not sorted");
          return 0;
        }
        gLastA = absA + 1;
        gSaw = 1;
        if (absA < gMinA) { gMinA = absA; }
        if (absA > gMaxA) { gMaxA = absA; }
      }
    }
  }

  fileClose(fh);

  if (gSaw == 0)
  {
    Fail("no APP data in HEX");
    return 0;
  }

  gStart = gMinA & 0xFFFFFFE0;
  if (gStart < cAppStart)
  {
    gStart = cAppStart;
  }
  gSize = (gMaxA - gStart) + 1;
  gSize = (gSize + 31) & 0xFFFFFFE0;
  if ((gStart + gSize - 1) > cAppEnd)
  {
    Fail("image exceeds APP window");
    return 0;
  }

  write("HEX APP %x size %d", gStart, gSize);
  SetI("BytesTotal", gSize);
  SetI("BytesSent", 0);
  SetI("Progress", 0);
  return 1;
}

/* IEEE-802.3 / AUTOSAR Crc_CalculateCRC32 — same as Boot_App_Crc32 / Boot_LastCrc. */
dword Crc32Feed(byte data[], dword len)
{
  dword crc;
  dword i;
  dword j;
  dword b;

  if (len == 0)
  {
    return gStreamCrc;
  }
  if (gStreamCrcOn == 0)
  {
    crc = 0xFFFFFFFF;
    gStreamCrcOn = 1;
  }
  else
  {
    crc = gStreamCrc ^ 0xFFFFFFFF;
  }
  for (i = 0; i < len; i++)
  {
    b = data[i];
    crc = crc ^ b;
    for (j = 0; j < 8; j++)
    {
      if ((crc & 1) != 0)
      {
        crc = (crc >> 1) ^ 0xEDB88320;
      }
      else
      {
        crc = crc >> 1;
      }
    }
  }
  gStreamCrc = crc ^ 0xFFFFFFFF;
  return gStreamCrc;
}

int SendChunk(void)
{
  dword i;
  dword n;
  dword len;

  n = gChunkLen;
  if (n == 0)
  {
    return 1;
  }
  if ((n % 32) != 0)
  {
    Fail("chunk not 32-aligned");
    return 0;
  }

  /* Accumulate host stream CRC before TX (order = ECU Boot_DlCrcOpen). */
  Crc32Feed(gChunk, n);

  gTd[0] = 0x36;
  gTd[1] = gBsc;
  for (i = 0; i < n; i++)
  {
    gTd[2 + i] = gChunk[i];
  }
  len = UdsRequest(gTd, 2 + n, gResp, 5000, cReqId);
  if ((len != 2) || (gResp[0] != 0x76) || (gResp[1] != gBsc))
  {
    if ((len >= 3) && (gResp[0] == 0x7F))
    {
      write("36 NRC %02X", gResp[2]);
    }
    Fail("36 rejected");
    return 0;
  }

  gBsc = (gBsc + 1) & 0xFF;
  gChunkLen = 0;
  SetI("BytesSent", gEmit - gStart);
  if (gSize > 0)
  {
    /* Erase used 0..30%; program fills 30..100%. */
    SetI("Progress", 30 + (((gEmit - gStart) * 70) / gSize));
  }
  /* Log every chunk so Write always shows program progress. */
  write("prog %d / %d  (%d%%)", gEmit - gStart, gSize,
        (int)(30 + (((gEmit - gStart) * 70) / gSize)));
  if (GetI("Abort") != 0)
  {
    Fail("aborted");
    return 0;
  }
  return 1;
}

int PutPad(void)
{
  /* Must match patch_app_header.py ERASE_BYTE and TC3xx erased PFlash. */
  gChunk[gChunkLen] = 0x00;
  gChunkLen++;
  gEmit++;
  if (gChunkLen >= cChunk)
  {
    return SendChunk();
  }
  return 1;
}

int PutVal(byte v)
{
  gChunk[gChunkLen] = v;
  gChunkLen++;
  gEmit++;
  if (gChunkLen >= cChunk)
  {
    return SendChunk();
  }
  return 1;
}

int PadUntil(dword addr)
{
  if (addr < gEmit)
  {
    Fail("HEX overlap/unsorted");
    return 0;
  }
  while (gEmit < addr)
  {
    if (PutPad() == 0)
    {
      return 0;
    }
  }
  return 1;
}

int ProgramHex(char path[])
{
  dword fh;
  char line[600];
  dword base;
  dword nn;
  dword offs;
  dword typ;
  dword i;
  dword absA;
  int nni;
  int ahi;
  int alo;
  int tpi;
  int b0;
  int b1;
  int v;

  fh = openFileRead(path, 0);
  if (fh == 0)
  {
    Fail("cannot reopen HEX");
    return 0;
  }

  base = 0;
  gChunkLen = 0;
  gEmit = gStart;
  gBsc = 0x01;
  gStreamCrc = 0;
  gStreamCrcOn = 0;

  while (fileGetString(line, elcount(line), fh) != 0)
  {
    if (line[0] != ':')
    {
      continue;
    }
    nni = HexByte(line, 1);
    ahi = HexByte(line, 3);
    alo = HexByte(line, 5);
    tpi = HexByte(line, 7);
    if ((nni < 0) || (ahi < 0) || (alo < 0) || (tpi < 0))
    {
      fileClose(fh);
      Fail("HEX parse error");
      return 0;
    }
    nn = nni;
    offs = ((dword)ahi << 8) | (dword)alo;
    typ = tpi;

    if (typ == 1)
    {
      break;
    }
    else if (typ == 4)
    {
      b0 = HexByte(line, 9);
      b1 = HexByte(line, 11);
      base = (((dword)b0 << 8) | (dword)b1) << 16;
    }
    else if (typ == 2)
    {
      b0 = HexByte(line, 9);
      b1 = HexByte(line, 11);
      base = (((dword)b0 << 8) | (dword)b1) << 4;
    }
    else if (typ == 0)
    {
      for (i = 0; i < nn; i++)
      {
        v = HexByte(line, 9 + (i * 2));
        absA = base + offs + i;
        if (InApp(absA) == 0)
        {
          continue;
        }
        if (PadUntil(absA) == 0)
        {
          fileClose(fh);
          return 0;
        }
        if (PutVal(v) == 0)
        {
          fileClose(fh);
          return 0;
        }
      }
    }
  }

  fileClose(fh);

  if (PadUntil(gStart + gSize) == 0)
  {
    return 0;
  }
  if (SendChunk() == 0)
  {
    return 0;
  }
  return 1;
}

/* =====================================================================
 * UDS flash sequence
 * ===================================================================== */

int EnterProg(void)
{
  byte req[2];
  dword len;

  req[0] = 0x10;
  req[1] = 0x02;
  len = UdsRequest(req, 2, gResp, 2000, cReqId);
  return ((len == 6) && (gResp[0] == 0x50) && (gResp[1] == 0x02));
}

int DoUnlockL1(void)
{
  byte req[6];
  dword len;
  dword seed;
  dword saKey;

  req[0] = 0x27;
  req[1] = 0x01;
  len = UdsRequest(req, 2, gResp, 2000, cReqId);
  if ((len != 6) || (gResp[0] != 0x67) || (gResp[1] != 0x01))
  {
    return 0;
  }
  seed = (((dword)gResp[2]) << 24) | (((dword)gResp[3]) << 16) |
         (((dword)gResp[4]) << 8)  | ((dword)gResp[5]);
  saKey = ~seed;
  req[0] = 0x27;
  req[1] = 0x02;
  req[2] = (saKey >> 24) & 0xFF;
  req[3] = (saKey >> 16) & 0xFF;
  req[4] = (saKey >> 8) & 0xFF;
  req[5] = saKey & 0xFF;
  len = UdsRequest(req, 6, gResp, 2000, cReqId);
  return ((len == 2) && (gResp[0] == 0x67) && (gResp[1] == 0x02));
}

int EraseApp(void)
{
  byte req[13];
  dword len;
  dword eStart;
  dword eEnd;
  dword eSize;
  dword totalSec;
  dword doneSec;
  dword nSec;
  dword chunkBytes;
  dword addr;

  /* Only erase HEX image window (sector-aligned), not full 1.875 MB APP. */
  eStart = gStart & ~(cSector - 1);
  eEnd = gStart + gSize;
  eEnd = (eEnd + cSector - 1) & ~(cSector - 1);
  if (eEnd <= eStart)
  {
    Fail("erase range empty");
    return 0;
  }
  eSize = eEnd - eStart;
  totalSec = eSize / cSector;
  if (totalSec == 0)
  {
    Fail("erase sector count 0");
    return 0;
  }

  write("erase range %x..%x (%d sectors, chunk=%d)", eStart, eEnd - 1, totalSec, cEraseChunkSectors);
  doneSec = 0;
  while (doneSec < totalSec)
  {
    if (GetI("Abort") != 0)
    {
      Fail("aborted during erase");
      return 0;
    }

    nSec = cEraseChunkSectors;
    if ((doneSec + nSec) > totalSec)
    {
      nSec = totalSec - doneSec;
    }
    chunkBytes = nSec * cSector;
    addr = eStart + (doneSec * cSector);

    write("erase chunk %d/%d @%x bytes=%d", doneSec + nSec, totalSec, addr, chunkBytes);
    SetProgress((doneSec * 30) / totalSec, "erasing APP (chunked)");

    req[0] = 0x31;
    req[1] = 0x01;
    req[2] = 0xFF;
    req[3] = 0x00;
    req[4] = 0x44;
    req[5] = (addr >> 24) & 0xFF;
    req[6] = (addr >> 16) & 0xFF;
    req[7] = (addr >> 8) & 0xFF;
    req[8] = addr & 0xFF;
    req[9] = (chunkBytes >> 24) & 0xFF;
    req[10] = (chunkBytes >> 16) & 0xFF;
    req[11] = (chunkBytes >> 8) & 0xFF;
    req[12] = chunkBytes & 0xFF;

    /* ~2 sectors: tens of seconds max; keep timeout generous. */
    len = UdsRequest(req, 13, gResp, 120000, cReqId);
    if (!((len == 4) && (gResp[0] == 0x71) && (gResp[1] == 0x01) &&
          (gResp[2] == 0xFF) && (gResp[3] == 0x00)))
    {
      if (len == 0)
      {
        write("erase: timeout chunk @%x len=%d", addr, chunkBytes);
      }
      else if ((len >= 3) && (gResp[0] == 0x7F))
      {
        write("erase: NRC 7F %02X %02X @%x", gResp[1], gResp[2], addr);
      }
      else
      {
        write("erase: bad resp len=%d SID=%02X @%x", len, (len > 0) ? gResp[0] : 0, addr);
      }
      return 0;
    }

    doneSec += nSec;
    SetProgress((doneSec * 30) / totalSec, "erasing APP (chunked)");
  }

  SetProgress(30, "erase done");
  return 1;
}

int RequestDownload(void)
{
  byte req[11];
  dword len;

  req[0] = 0x34;
  req[1] = 0x00;
  req[2] = 0x44;
  req[3] = (gStart >> 24) & 0xFF;
  req[4] = (gStart >> 16) & 0xFF;
  req[5] = (gStart >> 8) & 0xFF;
  req[6] = gStart & 0xFF;
  req[7] = (gSize >> 24) & 0xFF;
  req[8] = (gSize >> 16) & 0xFF;
  req[9] = (gSize >> 8) & 0xFF;
  req[10] = gSize & 0xFF;
  len = UdsRequest(req, 11, gResp, 2000, cReqId);
  return ((len == 4) && (gResp[0] == 0x74));
}

int TransferExit(void)
{
  byte req[1];
  dword len;

  req[0] = 0x37;
  len = UdsRequest(req, 1, gResp, 2000, cReqId);
  return ((len == 1) && (gResp[0] == 0x77));
}

int CheckMemory(dword crc)
{
  byte req[8];
  dword len;

  req[0] = 0x31;
  req[1] = 0x01;
  req[2] = 0xFF;
  req[3] = 0x02;
  req[4] = (crc >> 24) & 0xFF;
  req[5] = (crc >> 16) & 0xFF;
  req[6] = (crc >> 8) & 0xFF;
  req[7] = crc & 0xFF;
  write("31 FF02 host CRC %08X", crc);
  len = UdsRequest(req, 8, gResp, 5000, cReqId);
  if ((len >= 4) && (gResp[0] == 0x71) && (gResp[2] == 0xFF) && (gResp[3] == 0x02))
  {
    return 1;
  }
  if ((len >= 3) && (gResp[0] == 0x7F))
  {
    write("31 FF02 NRC %02X", gResp[2]);
  }
  return 0;
}

int StartRid(byte ridHi, byte ridLo)
{
  byte req[4];
  dword len;

  req[0] = 0x31;
  req[1] = 0x01;
  req[2] = ridHi;
  req[3] = ridLo;
  len = UdsRequest(req, 4, gResp, 5000, cReqId);
  return ((len >= 4) && (gResp[0] == 0x71));
}

void ToDefault(void)
{
  byte req[2];

  req[0] = 0x10;
  req[1] = 0x01;
  UdsRequest(req, 2, gResp, 2000, cReqId);
}

void RunFlash(void)
{
  char path[260];
  byte er[2];
  dword len;

  if (GetI("Busy") != 0)
  {
    return;
  }

  SetI("Abort", 0);
  SetI("Busy", 1);
  SetI("Progress", 0);
  SetI("BytesSent", 0);
  if (GetI("LogEnable") != 0)
  {
    if (LogOpen() == 0)
    {
      /* continue flash even if log failed */
    }
  }
  ResolvePath(path);
  if (strlen(path) < 4)
  {
    Fail("edit cHexDefault in Boot_FlashPanel.can");
    return;
  }
  write("Flash file: %s", path);

  SetProgress(0, "Parse HEX");
  if (ScanHex(path) == 0)
  {
    return;
  }

  SetProgress(2, "10 02 programming");
  if (EnterProg() == 0)
  {
    Fail("10 02 failed");
    return;
  }

  SetProgress(4, "27 unlock");
  if (DoUnlockL1() == 0)
  {
    Fail("unlock failed");
    ToDefault();
    return;
  }

  /* EraseApp updates Progress 0..30 via chunks */
  if (EraseApp() == 0)
  {
    Fail("erase failed");
    ToDefault();
    return;
  }

  SetProgress(32, "34 RequestDownload");
  if (RequestDownload() == 0)
  {
    Fail("34 failed");
    ToDefault();
    return;
  }

  SetProgress(35, "36 TransferData");
  if (ProgramHex(path) == 0)
  {
    LogClose();
    ToDefault();
    return;
  }

  SetProgress(95, "37 TransferExit");
  if (TransferExit() == 0)
  {
    Fail("37 failed");
    ToDefault();
    return;
  }

  SetProgress(97, "31 FF02 CheckMemory");
  if (CheckMemory(gStreamCrc) == 0)
  {
    Fail("31 FF02 CRC mismatch / rejected");
    ToDefault();
    return;
  }
  SetProgress(98, "31 FF01 CheckDep");
  StartRid(0xFF, 0x01);

  SetI("Progress", 100);
  SetI("BytesSent", gSize);

  if (GetI("DoReset") != 0)
  {
    SetS("Status", "11 01 reset");
    er[0] = 0x11;
    er[1] = 0x01;
    len = UdsRequest(er, 2, gResp, 2000, cReqId);
    if ((len >= 2) && (gResp[0] == 0x51))
    {
      SetS("Status", "Done (reset sent)");
    }
    else
    {
      SetS("Status", "Done (no 51 01)");
    }
  }
  else
  {
    SetS("Status", "Done");
  }

  SetI("Busy", 0);
  write("Flash DONE start=%x size=%d", gStart, gSize);
  LogClose();
}

/* ===================================================================== */

on preStart
{
  InitSys();
}

testcase TC_FlashPanel()
{
  TestCaseTitle("FlashPanel", "keep this test running, then click Start Flash");
  InitSys();
  SetI("Start", 0);
  SetI("Abort", 0);
  SetI("Busy", 0);
  SetI("LogRecording", 0);
  ApplyDefaultPath();
  ApplyDefaultLogPath();
  SetS("Status", "Ready - click Start Flash");
  write("Boot_FlashPanel: RUNNING. Do not stop. Click Start Flash on the panel.");
  TestStepPass("FlashPanel", "idle loop active");

  while (1)
  {
    if (GetI("LogUseDefault") != 0)
    {
      SetI("LogUseDefault", 0);
      ApplyDefaultLogPath();
    }
    if (GetI("Start") != 0)
    {
      SetI("Start", 0);
      RunFlash();
    }
    TestWaitForTimeout(20);
  }
}

void MainTest()
{
  TC_FlashPanel();
}
