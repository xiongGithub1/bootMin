AUTOSAR XML (schema 00048)
package /ActiveEcuC
  module config Com: implementation-config-variant=VARIANT-PRE-COMPILE, module-description=Com_Impl
    ComGeneration:
      ComOutOfBoundsWriteProtectionStrategy = NONE
      ComOutOfBoundsWriteSanitizer = false
      ComOutOfBoundsReadSanitizer = false
      ComReduceConstantData2Define = false
      ComBoolDataInArrayOfStructStrategy = BOOLEAN
      ComDeduplicateIndirectedData = true
      ComDataDeduplicationStrategy = WITH_CAST
      ComReduceBoolDataByNegationThreshold = 2
      ComReduceBoolDataByNumericalComparisonThreshold = 2
      ComReduceBoolDataByNumericalRelationThreshold = 2
      ComReduceBoolDataByNumericalOperandStrategy = WITH_ANY_VALUE
      ComReduceNumericalDataByOffsetThreshold = 2
      ComReduceNumericalDataByArraySubtractionThreshold = 2
      ComReduceDataByStreaming = false
      ComShortSymbols = false
      ComInterfacesForDeactivatedData = false
      ComReferringKeysInComments = false
      ComNumberOfElementsCommentThreshold = 1000
    ComOptimization:
      ComTxProcessingISRLockThreshold = 1
      ComRxProcessingISRLockThreshold = 1
      ComGatewayProcessingISRLockThreshold = 1
      ComGatewayDescriptionProcessingISRLockThreshold = 1
      ComIPduGroupISRLockThreshold = 1
    ComConfig: ComConfigurationId=0, ComRxDeferredNotificationCacheSize=0, ComRxImmediateNotificationCacheSize=0
      MyECU_oCAN00_Rx_4cbf71f7 (ComIPduGroup): ComIPduGroupHandleId=0
      sig_LampCnt_omsg_MyECU_Lamp_oCAN00_f37e68ea_Tx (ComSignal):
        ComBitPosition = 7
        ComBitSize = 8
        ComSignalEndianness = BIG_ENDIAN
        ComSignalInitValue = 0
        ComSignalType = UINT8
        ComTransferProperty = PENDING
        ComSignalAccess = ACCESS_UNCLEAR
        ComHandleId = 0
        ComSystemTemplateSystemSignalRef = sig_LampCnt
      msg_Transmit_oCAN00_0723e95e_Tx (ComIPdu):
        ComIPduDirection = SEND
        ComIPduType = NORMAL
        ComIPduHandleId = 2
        ComIPduSignalProcessing = DEFERRED
        ComIPduCancellationSupport = false
        ComIPduGroupRef = MyECU_oCAN00_Tx_1ae5d671
        ComIPduSignalRef = sig_RearInteriorLight_omsg_Transmit_oCAN00_49a633c1_Tx
        ComPduIdRef = msg_Transmit_oCAN00_0723e95e_Tx
        ComTxIPdu: ComMinimumDelayTime=0, ComTxIPduUnusedAreasDefault=0
          ComTxModeTrue
            ComTxMode: ComTxModeMode=PERIODIC, ComTxModeTimeOffset=0, ComTxModeTimePeriod=0.1
          ComTxModeFalse
            ComTxMode: ComTxModeMode=PERIODIC, ComTxModeTimeOffset=0, ComTxModeTimePeriod=0.1
      sig_State_RearInteriorLight_omsg_Receive_oCAN00_63323183_Rx (ComSignal):
        ComBitPosition = 2
        ComBitSize = 1
        ComSignalEndianness = LITTLE_ENDIAN
        ComSignalInitValue = 0
        ComSignalType = BOOLEAN
        ComTimeout = 0
        ComSignalAccess = ACCESS_UNCLEAR
        ComHandleId = 0
        ComSystemTemplateSystemSignalRef = sig_State_RearInteriorLight
      sig_State_RearRightDoor_omsg_Receive_oCAN00_a8945098_Rx (ComSignal):
        ComBitPosition = 1
        ComBitSize = 1
        ComSignalEndianness = LITTLE_ENDIAN
        ComSignalInitValue = 0
        ComSignalType = BOOLEAN
        ComTimeout = 0
        ComSignalAccess = ACCESS_UNCLEAR
        ComHandleId = 2
        ComSystemTemplateSystemSignalRef = sig_State_RearRightDoor
      msg_Receive_oCAN00_2b456e3f_Rx (ComIPdu):
        ComIPduDirection = RECEIVE
        ComIPduType = NORMAL
        ComIPduHandleId = 0
        ComIPduSignalProcessing = DEFERRED
        ComIPduCancellationSupport = false
        ComIPduGroupRef = MyECU_oCAN00_Rx_4cbf71f7
        ComIPduSignalRef = sig_State_RearInteriorLight_omsg_Receive_oCAN00_63323183_Rx
        ComIPduSignalRef = sig_State_RearLeftDoor_omsg_Receive_oCAN00_84ad4140_Rx
        ComIPduSignalRef = sig_State_RearRightDoor_omsg_Receive_oCAN00_a8945098_Rx
        ComPduIdRef = msg_Receive_oCAN00_2b456e3f_Rx
      sig_NM_MyECU_UserData_0_omsg_NM_MyECU_oCAN00_e960d558_Tx (ComSignal):
        ComBitPosition = 8
        ComBitSize = 8
        ComSignalEndianness = LITTLE_ENDIAN
        ComSignalInitValue = 0
        ComSignalType = UINT8
        ComTransferProperty = PENDING
        ComSignalAccess = ACCESS_UNCLEAR
        ComHandleId = 2
        ComSystemTemplateSystemSignalRef = sig_NM_MyECU_UserData_0
      msg_NM_MyECU_oCAN00_d71a6287_Tx (ComIPdu):
        ComIPduDirection = SEND
        ComIPduType = NORMAL
        ComIPduHandleId = 1
        ComIPduSignalProcessing = DEFERRED
        ComIPduCancellationSupport = false
        ComIPduSignalRef = sig_NM_MyECU_CBV_omsg_NM_MyECU_oCAN00_44971011_Tx
        ComIPduSignalRef = sig_NM_MyECU_UserData_0_omsg_NM_MyECU_oCAN00_e960d558_Tx
        ComIPduSignalRef = sig_NM_MyECU_UserData_1_omsg_NM_MyECU_oCAN00_fe48b198_Tx
        ComIPduSignalRef = sig_NM_MyECU_UserData_2_omsg_NM_MyECU_oCAN00_c7301cd8_Tx
        ComIPduSignalRef = sig_NM_MyECU_UserData_3_omsg_NM_MyECU_oCAN00_d0187818_Tx
        ComIPduSignalRef = sig_NM_MyECU_UserData_4_omsg_NM_MyECU_oCAN00_b5c14658_Tx
        ComIPduSignalRef = sig_NM_MyECU_UserData_5_omsg_NM_MyECU_oCAN00_a2e92298_Tx
        ComPduIdRef = msg_NM_MyECU_oCAN00_d71a6287_Tx
        ComTxIPdu: ComTxIPduUnusedAreasDefault=0, ComMinimumDelayTime=0  # msg_NM_MyECU_oCAN00
          ComTxModeTrue
            ComTxMode: ComTxModeMode=NONE
          ComTxModeFalse
            ComTxMode: ComTxModeMode=NONE
      6 x ComSignal, all with ComSignalEndianness=LITTLE_ENDIAN, ComSignalInitValue=0, ComSignalAccess=ACCESS_UNCLEAR:
        sig_NM_MyECU_UserData_2_omsg_NM_MyECU_oCAN00_c7301cd8_Tx: ComBitPosition=24, ComBitSize=8, ComSignalType=UINT8, ComTransferProperty=PENDING, ComHandleId=4, ComSystemTemplateSystemSignalRef=sig_NM_MyECU_UserData_2
        sig_NM_MyECU_UserData_4_omsg_NM_MyECU_oCAN00_b5c14658_Tx: ComBitPosition=40, ComBitSize=8, ComSignalType=UINT8, ComTransferProperty=PENDING, ComHandleId=6, ComSystemTemplateSystemSignalRef=sig_NM_MyECU_UserData_4
        sig_NM_MyECU_CBV_omsg_NM_MyECU_oCAN00_44971011_Tx: ComBitPosition=0, ComBitSize=8, ComSignalType=UINT8, ComTransferProperty=PENDING, ComHandleId=1, ComSystemTemplateSystemSignalRef=sig_NM_MyECU_CBV
        sig_State_RearLeftDoor_omsg_Receive_oCAN00_84ad4140_Rx: ComBitPosition=0, ComBitSize=1, ComSignalType=BOOLEAN, ComTimeout=0, ComHandleId=1, ComSystemTemplateSystemSignalRef=sig_State_RearLeftDoor
        sig_NM_MyECU_UserData_1_omsg_NM_MyECU_oCAN00_fe48b198_Tx: ComBitPosition=16, ComBitSize=8, ComSignalType=UINT8, ComTransferProperty=PENDING, ComHandleId=3, ComSystemTemplateSystemSignalRef=sig_NM_MyECU_UserData_1
        sig_NM_MyECU_UserData_5_omsg_NM_MyECU_oCAN00_a2e92298_Tx: ComBitPosition=48, ComBitSize=8, ComSignalType=UINT8, ComTransferProperty=PENDING, ComHandleId=7, ComSystemTemplateSystemSignalRef=sig_NM_MyECU_UserData_5
      MyECU_oCAN00_Tx_1ae5d671 (ComIPduGroup): ComIPduGroupHandleId=1
      sig_NM_MyECU_UserData_3_omsg_NM_MyECU_oCAN00_d0187818_Tx (ComSignal):
        ComBitPosition = 32
        ComBitSize = 8
        ComSignalEndianness = LITTLE_ENDIAN
        ComSignalInitValue = 0
        ComSignalType = UINT8
        ComTransferProperty = PENDING
        ComSignalAccess = ACCESS_UNCLEAR
        ComHandleId = 5
        ComSystemTemplateSystemSignalRef = sig_NM_MyECU_UserData_3
      msg_MyECU_Lamp_oCAN00_818e1651_Tx (ComIPdu):
        ComIPduDirection = SEND
        ComIPduType = NORMAL
        ComIPduHandleId = 0
        ComIPduSignalProcessing = DEFERRED
        ComIPduCancellationSupport = false
        ComIPduGroupRef = MyECU_oCAN00_Tx_1ae5d671
        ComIPduSignalRef = sig_LampCnt_omsg_MyECU_Lamp_oCAN00_f37e68ea_Tx
        ComPduIdRef = msg_MyECU_Lamp_oCAN00_818e1651_Tx
        ComTxIPdu: ComMinimumDelayTime=0, ComTxIPduUnusedAreasDefault=0
          ComTxModeTrue
            ComTxMode: ComTxModeMode=PERIODIC, ComTxModeTimeOffset=0, ComTxModeTimePeriod=0.1
          ComTxModeFalse
            ComTxMode: ComTxModeMode=PERIODIC, ComTxModeTimeOffset=0, ComTxModeTimePeriod=0.1
      sig_RearInteriorLight_omsg_Transmit_oCAN00_49a633c1_Tx (ComSignal):
        ComBitPosition = 0
        ComBitSize = 1
        ComSignalEndianness = LITTLE_ENDIAN
        ComSignalInitValue = 0
        ComSignalType = BOOLEAN
        ComTransferProperty = PENDING
        ComSignalAccess = ACCESS_UNCLEAR
        ComHandleId = 8
        ComSystemTemplateSystemSignalRef = sig_RearInteriorLight
      ComMainFunctionTx: ComMainTxTimeBase=0.01
      ComMainFunctionRx: ComMainRxTimeBase=0.01
    ComGeneral:
      ComConfigurationUseDet = true
      ComSafeBswChecks = false
      ComEnableSignalGroupArrayApi = false
      ComRetryFailedTransmitRequests = false
      ComSupportedIPduGroups = 2
      ComVersionInfoApi = false
      ComMetaDataSupport = false
      ComDeferredEventCacheSupport = false
      ComDescriptionGateway = false
      ComStrictRepetitionPeriod = false
      ComMixedModePeriodicSuppression = false
      ComSignalGateway = NONE
      ComMultiPartition = false
