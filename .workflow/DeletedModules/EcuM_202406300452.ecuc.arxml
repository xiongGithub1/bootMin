AUTOSAR XML (schema 00048)
package /ActiveEcuC
  module config EcuM: implementation-config-variant=VARIANT-PRE-COMPILE, module-description=EcuM_Impl
    EcuMConfiguration
      EcuMCommonConfiguration: EcuMConfigConsistencyHash=8339911702629809127, EcuMDefaultAppMode=OSDEFAULTAPPMODE, EcuMOSResource=OsResource_EcuM
        5 x EcuMWakeupSource, all with EcuMValidationTimeout=0, EcuMCheckWakeupTimeout=0, EcuMWakeupSourcePolling=false:
          ECUM_WKSOURCE_POWER: EcuMWakeupSourceId=0
          ECUM_WKSOURCE_RESET: EcuMWakeupSourceId=1
          ECUM_WKSOURCE_INTERNAL_RESET: EcuMWakeupSourceId=2
          ECUM_WKSOURCE_INTERNAL_WDG: EcuMWakeupSourceId=3
          ECUM_WKSOURCE_EXTERNAL_WDG: EcuMWakeupSourceId=4
        EcuMDefaultShutdownTarget: EcuMDefaultState=EcuMStateOff
        EcuMDriverInitListZero
          3 x EcuMDriverInitItem:
            BswM_InitMemory: EcuMModuleID=BswM, EcuMModuleHeader=BswM.h, EcuMModuleService=BswM_InitMemory
            Det_InitMemory: EcuMModuleID=Det, EcuMModuleHeader=Det.h, EcuMModuleService=Det_InitMemory
            Rte_InitMemory: EcuMModuleID=Rte, EcuMModuleHeader=Rte_Main.h, EcuMModuleService=Rte_InitMemory
        EcuMDriverInitListOne
          5 x EcuMDriverInitItem:
            Mcu_Init: EcuMModuleID=Mcu, EcuMModuleHeader=Mcu.h, EcuMModuleService=Mcu_Init
            Mcu_InitClock: EcuMModuleID=Code, EcuMAdditionalInitCode=Mcu_InitClock(McuConf_McuModeSettingConf_McuModeSettingConf_0)
            Mcu_GetPllStatus: EcuMModuleID=Code, EcuMAdditionalInitCode=while (Mcu_GetPllStatus() != MCU_PLL_LOCKED)
            Mcu_DistributePllClock: EcuMModuleID=Code, EcuMAdditionalInitCode=Mcu_DistributePllClock()
            Port_Init: EcuMModuleID=Port, EcuMModuleHeader=Port.h, EcuMModuleService=Port_Init
        CN_CAN00_5e566ad9 (EcuMWakeupSource): EcuMWakeupSourceId=5, EcuMWakeupSourcePolling=false, EcuMComMChannelRef=CN_CAN00_5e566ad9
        EcuMDriverRestartList
      EcuMFlexConfiguration: EcuMFlexModuleConfigurationRef=CanConfigSet, EcuMNormalMcuModeRef=McuModeSettingConf_0
        3 x EcuMResetMode:
          ECUM_RESET_MCU: EcuMResetModeId=0
          ECUM_RESET_WDG: EcuMResetModeId=1
          ECUM_RESET_IO: EcuMResetModeId=2
        4 x EcuMShutdownCause:
          ECUM_CAUSE_UNKNOWN: EcuMShutdownCauseId=0
          ECUM_CAUSE_ECU_STATE: EcuMShutdownCauseId=1
          ECUM_CAUSE_WDGM: EcuMShutdownCauseId=2
          ECUM_CAUSE_DCM: EcuMShutdownCauseId=3
        ECUM_RESET_WAKEUP (EcuMResetMode): EcuMResetModeId=3
      EcuMFixedConfiguration: EcuMNvramWriteallTimeout=60, EcuMRunMinimumDuration=5, EcuMNormalMcuModeRef=McuModeSettingConf_0
        EcuMFixedUserConfig: EcuMFixedUser=0
    EcuMGeneral:
      EcuMDevErrorDetect = true
      EcuMIncludeDem = false
      EcuMIncludeDet = false
      EcuMMainFunctionPeriod = 0.01
      EcuMVersionInfoApi = false
      EcuMDeferredBswMNotification = false
      EcuMSlaveCoreHandling = false
      EcuMEnableFixBehavior = true
      EcuMNonChannelWakeupInRun = false
      EcuMSchMStartInitialization = true
      EcuMSafeBswChecks = false
      EcuMGeneration: EcuMOutOfBoundsWriteSanitizer=false, EcuMOutOfBoundsReadSanitizer=false, EcuMInterfacesForDeactivatedData=false
    EcuMFlexGeneral: EcuMAlarmClockPresent=false
    EcuMFixedGeneral: EcuMIncludeComM=false, EcuMIncludeNvramMgr=false, EcuMIncludeRte=true, EcuMGenModeSwitchPort=true, EcuMModeSwitchRteAck=true, EcuMIncludeDem=false
