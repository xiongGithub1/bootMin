AUTOSAR XML (schema 00048)
package /ActiveEcuC
  module config CanNm: implementation-config-variant=VARIANT-PRE-COMPILE, module-description=CanNm_Impl
    CanNmGlobalConfig:
      CanNmComUserDataSupport = true
      CanNmPnEiraCalcEnabled = false
      CanNmUserDataEnabled = true
      CanNmBusLoadReductionEnabled = false
      CanNmBusSynchronizationEnabled = false
      CanNmCoordinatorSyncSupport = false
      CanNmDevErrorDetect = true
      CanNmImmediateTxconfEnabled = false
      CanNmMainFunctionPeriod = 0.01
      CanNmPassiveModeEnabled = false
      CanNmPduRxIndicationEnabled = false
      CanNmRemoteSleepIndEnabled = false
      CanNmStateChangeIndEnabled = false
      CanNmVersionInfoApi = false
      CanNmDisableTxErrReport = false
      CanNmApiOptimization = false
      CanNmCanIfRangeConfigDLCCheck = true
      CanNmRuntimeMeasurementSupport = false
      CanNmSafeBswChecks = false
      CAN00_CAN_5faa4e95 (CanNmChannelConfig):
        CanNmMsgCycleOffset = 0
        CanNmNodeId = 0
        CanNmPduCbvPosition = CANNM_PDU_BYTE_1
        CanNmPduNidPosition = CANNM_PDU_BYTE_0
        CanNmUserDataLength = 7
        CanNmBusLoadReductionActive = false
        CanNmCarWakeUpRxEnabled = false
        CanNmImmediateNmTransmissions = 0
        CanNmMsgCycleTime = 0.1
        CanNmMsgReducedTime = 0.08
        CanNmMsgTimeoutTime = 0.06
        CanNmRemoteSleepIndTime = 0.5
        CanNmRepeatMessageTime = 0.4
        CanNmTimeoutTime = 1
        CanNmWaitBusSleepTime = 0.75
        CanNmActiveWakeupBitEnabled = false
        CanNmNodeIdEnabled = false
        CanNmNodeDetectionEnabled = false
        CanNmRepeatMsgIndEnabled = false
        CanNmImmediateRestartEnabled = false
        CanNmComControlEnabled = false
        CanNmCriBitAlwaysEnabled = false
        CanNmComMNetworkHandleRef = CN_CAN00_5e566ad9
        msg_NM_MyECU_oCAN00_e64db31b (CanNmUserDataTxPdu): CanNmTxUserDataPduId=0, CanNmTxUserDataPduRef=msg_NM_MyECU_oCAN00_d71a6287_Tx
        CAN00_CAN_5faa4e95_Rx (CanNmRxPdu): CanNmRxPduId=0, CanNmRxPduRef=MyECU_df2f1767_Rx
        msg_NM_MyECU_oCAN00_3046ada9_Tx (CanNmTxPdu): CanNmTxConfirmationPduId=0, CanNmTxPduRef=msg_NM_MyECU_oCAN00_3046ada9_Tx
      CanNmGeneration: CanNmOutOfBoundsWriteSanitizer=false, CanNmOutOfBoundsReadSanitizer=false, CanNmInterfacesForDeactivatedData=false
