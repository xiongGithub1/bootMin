AUTOSAR XML (schema 4-2-2)
# Copyright (C) Infineon Technologies (2020)
# All rights reserved.
package /AURIX2G_FlsLoader/BswModuleDescriptions
  bsw module description FlsLoader: category=BSW_MODULE, module-id=255, provided-entrys=[FlsLoader_Init, FlsLoader_DeInit, FlsLoader_Write, FlsLoader_Erase, FlsLoader_Lock, FlsLoader_UnLock]  # Flash (PFlash and DFlash) driver
    bsw module dependency DetDependency: target-module-id=15, required-entrys=Det_ReportError
    bsw module dependency McalLibDependency: target-module-id=255, required-entrys=[Mcal_WritePeripEndInitProtReg, Mcal_DelayGetTick, Mcal_DelayTickResolution]
    bsw internal behavior FlsLoaderBehavior
      6 x bsw called entity, all with reentrancy-level=NON-REENTRANT:
        FlsLoader_Init: implemented-entry=FlsLoader_Init
        FlsLoader_DeInit: implemented-entry=FlsLoader_DeInit
        FlsLoader_Write: implemented-entry=FlsLoader_Write
        FlsLoader_Erase: implemented-entry=FlsLoader_Erase
        FlsLoader_Lock: implemented-entry=FlsLoader_Lock
        FlsLoader_UnLock: implemented-entry=FlsLoader_UnLock
package /AURIX2G_FlsLoader/BswModuleEntrys
  6 x bsw module entry, all with is-reentrant=false, is-synchronous=true, call-type=REGULAR, execution-context=TASK, sw-service-impl-policy=STANDARD:
    FlsLoader_Init: service-id=47
      return type Return: implementation-data-type=FlsLoader_ReturnType
      sw service arg Address: category=DATA_REFERENCE, sw-pointer-target-props={target-category=TYPE_REFERENCE, implementation-data-type=FlsLoader_ConfigType}
    FlsLoader_DeInit: service-id=48
      return type Return: implementation-data-type=FlsLoader_ReturnType
    FlsLoader_Write: service-id=49
      return type Return: implementation-data-type=FlsLoader_ReturnType
      sw service arg TargetAddress: implementation-data-type=FlsLoader_AddressType
      sw service arg Length: implementation-data-type=FlsLoader_LengthType
      sw service arg SourceAddressPtr: category=DATA_REFERENCE, sw-pointer-target-props={target-category=TYPE_REFERENCE, implementation-data-type=uint8}
    FlsLoader_Erase: service-id=50
      return type Return: implementation-data-type=FlsLoader_ReturnType
      sw service arg TargetAddress: implementation-data-type=FlsLoader_AddressType
      sw service arg Length: implementation-data-type=FlsLoader_LengthType
    FlsLoader_Lock: service-id=51
      return type Return: implementation-data-type=FlsLoader_ReturnType
    FlsLoader_UnLock: service-id=52
      return type Return: implementation-data-type=FlsLoader_ReturnType
      sw service arg TargetAddress: implementation-data-type=FlsLoader_AddressType
      sw service arg Password: category=DATA_REFERENCE, sw-pointer-target-props={target-category=TYPE_REFERENCE, implementation-data-type=FlsLoader_ValueType}
package /AURIX2G_FlsLoader/Implementations
  bsw implementation FlsLoader: programming-language=C, sw-version=20.0.0, vendor-id=17, ar-release-version=4.2.2, behavior=FlsLoaderBehavior, vendor-specific-module-def=FlsLoader
    code-descriptors:
      code Files
        artifact-descriptors:
          short-label=ssc::src::FlsLoader.c, category=SWSRC
          short-label=ssc::inc::FlsLoader.h, category=SWHDR
          short-label=ssc::src::FlsLoader_Platform.c, category=SWSRC
          short-label=ssc::inc::FlsLoader_Local.h, category=SWHDR
    generated-artifacts:
      4 x dependency on artifact:
        FlsLoader_Cfg_c: artifact-descriptor={short-label=generate::template::src::FlsLoader_Cfg.c, category=SWTEMPLATE}, usages=COMPILE
        FlsLoader_Cfg_h: artifact-descriptor={short-label=generate::template::inc::FlsLoader_Cfg.h, category=SWTEMPLATE}, usages=COMPILE
        FlsLoader_xdm: artifact-descriptor={short-label=config::FlsLoader.xdm, category=SWTOOL}, usages=CODEGENERATION
        FlsLoader_bmd: artifact-descriptor={short-label=autosar::TC36x::TC364x_TQFP::FlsLoader.bmd, category=SWTOOL}, usages=CODEGENERATION
    resource consumption ResourceConsumption
      6 x memory section:
        CODE_QM_LOCAL: alignment=UNSPECIFIED, sw-addrmethod=CODE
        WRITEERASE_CODE_QM_LOCAL: alignment=UNSPECIFIED, sw-addrmethod=CODE
        VAR_CLEARED_QM_LOCAL_8: alignment=8, sw-addrmethod=VAR_CLEARED
        VAR_CLEARED_QM_LOCAL_32: alignment=32, sw-addrmethod=VAR_CLEARED
        CONST_QM_LOCAL_8: alignment=8, sw-addrmethod=CONST
        CONST_QM_LOCAL_32: alignment=32, sw-addrmethod=CONST
      section name prefix FLSLOADER
package /AURIX2G_FlsLoader/ImplementationDataTypes
  6 x impl type, all with type-emitter=BSW:
    FlsLoader_AddressType: implementation-data-type=uint32
    FlsLoader_CallOutFunc: category=FUNCTION_REFERENCE, sw-pointer-target-props=FlsLoader_LoopCallOut
    FlsLoader_ConfigType: implementation-data-type=void
    FlsLoader_LengthType: implementation-data-type=uint32
    FlsLoader_ReturnType: implementation-data-type=uint32
    FlsLoader_ValueType: implementation-data-type=uint32
