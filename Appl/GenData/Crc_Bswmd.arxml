AUTOSAR XML (schema 4-2-2)
# Copyright (C) Infineon Technologies (2021)
# All rights reserved.
package /AUTOSAR_Crc/BswModuleDescriptions
  bsw module description Crc: category=BSW_MODULE, module-id=201, provided-entrys=[Crc_CalculateCRC16, Crc_CalculateCRC32]  # Cyclic Redundacy Check
    bsw module dependency McalLibDependency: target-module-id=255, required-entrys=Mcal_WritePeripEndInitProtReg
    bsw internal behavior CrcBehavior
      bsw called entity Crc_CalculateCRC16: reentrancy-level=MULTICORE-REENTRANT, implemented-entry=Crc_CalculateCRC16
      bsw called entity Crc_CalculateCRC32: reentrancy-level=MULTICORE-REENTRANT, implemented-entry=Crc_CalculateCRC32
package /AUTOSAR_Crc/BswModuleEntrys
  bsw module entry Crc_CalculateCRC16: service-id=2, is-reentrant=true, is-synchronous=true, call-type=REGULAR, execution-context=TASK, sw-service-impl-policy=STANDARD
    return type Return: implementation-data-type=uint16
    4 x sw service arg:
      Crc_DataPtr: category=DATA_REFERENCE, sw-pointer-target-props={target-category=TYPE_REFERENCE, implementation-data-type=uint8}
      Crc_Length: implementation-data-type=uint32
      Crc_StartValue16: implementation-data-type=uint16
      Crc_IsFirstCall: implementation-data-type=boolean
  bsw module entry Crc_CalculateCRC32: service-id=3, is-reentrant=true, is-synchronous=true, call-type=REGULAR, execution-context=TASK, sw-service-impl-policy=STANDARD
    return type Return: implementation-data-type=uint32
    4 x sw service arg:
      Crc_DataPtr: category=DATA_REFERENCE, sw-pointer-target-props={target-category=TYPE_REFERENCE, implementation-data-type=uint8}
      Crc_Length: implementation-data-type=uint32
      Crc_StartValue32: implementation-data-type=uint32
      Crc_IsFirstCall: implementation-data-type=boolean
package /AUTOSAR_Crc/Implementations
  bsw implementation Crc: programming-language=C, sw-version=20.0.2, vendor-id=17, ar-release-version=4.2.2, behavior=CrcBehavior, vendor-specific-module-def=Crc
    code-descriptors:
      code Files: artifact-descriptors=[{short-label=ssc::src::Crc.c, category=SWSRC}, {short-label=ssc::inc::Crc.h, category=SWHDR}]
    generated-artifacts:
      4 x dependency on artifact:
        Crc_Cfg_h: artifact-descriptor={short-label=generate::template::inc::Crc_Cfg.h, category=SWTEMPLATE}, usages=COMPILE
        Crc_Cfg_c: artifact-descriptor={short-label=generate::template::src::Crc_Cfg.c, category=SWTEMPLATE}, usages=COMPILE
        Crc_xdm: artifact-descriptor={short-label=config::Crc.xdm, category=SWTOOL}, usages=CODEGENERATION
        Crc_bmd: artifact-descriptor={short-label=autosar::TC36x::TC364x_TQFP::Crc.bmd, category=SWTOOL}, usages=CODEGENERATION
    resource consumption ResourceConsumption
      9 x memory section:
        CONFIG_DATA_ASIL_B_GLOBAL_UNSPECIFIED: alignment=UNSPECIFIED, sw-addrmethod=CONFIG_DATA
        CONST_ASIL_B_GLOBAL_UNSPECIFIED: alignment=UNSPECIFIED, sw-addrmethod=CONST
        VAR_INIT_ASIL_B_CORE{0..5}_32: alignment=32, sw-addrmethod=VAR_INIT
        CODE_ASIL_B_GLOBAL: alignment=UNSPECIFIED, sw-addrmethod=CODE
      section name prefix CRC
