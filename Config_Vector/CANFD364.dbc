VERSION "Boot_DiagOnly_1.0"

NS_ :

BS_:

BU_: Tester MyECU

BO_ 1868 msg_diag_Request_MyECU: 8 Tester
 SG_ Signal_DiagRequestMyECU : 0|64@1+ (1,0) [0|1.8446744074E+019] ""  MyECU

BO_ 1884 msg_diag_Response_MyECU: 8 MyECU
 SG_ Signal_DiagResponseMyECU : 0|64@1+ (1,0) [0|1.8446744074E+019] ""  Tester

BO_ 2015 msg_diag_RequestGlobal: 8 Tester
 SG_ Signal_DiagRequestGlobal : 0|64@1+ (1,0) [0|1.8446744074E+019] ""  MyECU

CM_ "Boot-only communication matrix: UDS diagnostic frames only (no App/Com/Nm). phys req 0x74C, phys resp 0x75C, func req 0x7DF.";
CM_ BO_ 1868 "UDS physical request (ID 0x74C, Tester -> MyECU), 8 bytes classic CAN. CanTp Rx (physical).";
CM_ BO_ 1884 "UDS physical response (ID 0x75C, MyECU -> Tester), 8 bytes classic CAN. CanTp Tx.";
CM_ BO_ 2015 "UDS functional request (ID 0x7DF, broadcast), 8 bytes classic CAN. CanTp Rx (functional).";

BA_DEF_ BO_  "VFrameFormat" ENUM  "StandardCAN","ExtendedCAN","reserved","reserved","reserved","reserved","reserved","reserved","reserved","reserved","reserved","reserved","reserved","reserved","StandardCAN_FD","ExtendedCAN_FD";
BA_DEF_ BO_  "GenMsgCycleTime" INT 0 100000;
BA_DEF_ BO_  "GenMsgSendType" ENUM  "cyclicX","spontanX","cyclicIfActiveX","spontanWithDelay","cyclicAndSpontanX","cyclicAndSpontanWithDelay","spontanWithRepetition","cyclicIfActiveAndSpontanWD","cyclicIfActiveFast","cyclicWithRepeatOnDemand";
BA_DEF_  "Baudrate" INT 0 1000000;
BA_DEF_  "BusType" STRING ;
BA_DEF_  "Manufacturer" STRING ;
BA_DEF_ BU_  "ILUsed" ENUM  "No","Yes";
BA_DEF_ BO_  "GenMsgILSupport" ENUM  "No","Yes";
BA_DEF_ BO_  "DiagConnection" INT 0 65535;
BA_DEF_ BO_  "DiagRequest" ENUM  "No","Yes";
BA_DEF_ BO_  "DiagResponse" ENUM  "No","Yes";

BA_DEF_DEF_  "VFrameFormat" "StandardCAN";
BA_DEF_DEF_  "GenMsgCycleTime" 0;
BA_DEF_DEF_  "GenMsgSendType" "spontanX";
BA_DEF_DEF_  "Baudrate" 500000;
BA_DEF_DEF_  "BusType" "CAN";
BA_DEF_DEF_  "Manufacturer" "Vector";
BA_DEF_DEF_  "ILUsed" "No";
BA_DEF_DEF_  "GenMsgILSupport" "No";
BA_DEF_DEF_  "DiagConnection" 0;
BA_DEF_DEF_  "DiagRequest" "No";
BA_DEF_DEF_  "DiagResponse" "No";

BA_ "DiagConnection" BO_ 1868 57345;
BA_ "DiagRequest" BO_ 1868 1;

BA_ "DiagConnection" BO_ 1884 57345;
BA_ "DiagResponse" BO_ 1884 1;

BA_ "DiagConnection" BO_ 2015 57345;
BA_ "DiagRequest" BO_ 2015 1;
