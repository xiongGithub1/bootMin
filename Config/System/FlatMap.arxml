AUTOSAR XML (schema 00050)
package /COM/VECTOR/CFG/WORKFLOW/SYSDESC/SYNC
  flat map FLATMAP
    flat instance descriptor StartApp: upstream-reference=EcuSwComposition.StartApp, ecu-extract-reference=COMPOSITIONTYPE.StartApp
