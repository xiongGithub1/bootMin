AUTOSAR XML (schema 00048)
package /VehicleProject
  system System
package /Diagnostics
  diagnostic contribution set DiagnosticContributionSet: ecu-instance=MyECU, service-tables=DS_MyECU
  diagnostic service table DS_MyECU: diagnostic-connections=DC_0xE001_oMyECU_oCAN00, ecu-instance=MyECU
  diagnostic connection DC_0xE001_oMyECU_oCAN00: physical-request=msg_diag_Request_MyECU_oTN_0x0001_MyECU, response=msg_diag_Response_MyECU_oTN_0x0001_MyECU
package /TP
  can tp config CAN00_CAN: communication-cluster=CAN00, can-tp-ecu{cycle-time-main-function=0.005, ecu-instance=MyECU}
    can tp address TA_0x0001: tp-address=1
    can tp address TA_0x00E0: tp-address=224
    can tp channel TPCH: channel-id=0, channel-mode=FULL-DUPLEX-MODE
    can-tp-connection addressing-format=STANDARD, can-tp-channel=TPCH, data-pdu=msg_diag_Request_MyECU_Tp_oCAN00, flow-control-pdu=msg_diag_Response_MyECU_Tp_oCAN00, receiver=TN_0x0001_MyECU, ta-type=PHYSICAL, tp-sdu=msg_diag_Request_MyECU_oCAN00, transmitter=TN_0x00E0_Tester:
      ident msg_diag_Request_MyECU_oTN_0x0001_MyECU
    can-tp-connection addressing-format=STANDARD, can-tp-channel=TPCH, data-pdu=msg_diag_RequestGlobal_Tp_oCAN00, flow-control-pdu=msg_diag_Response_MyECU_Tp_oCAN00, receiver=TN_0x0001_MyECU, ta-type=PHYSICAL, tp-sdu=msg_diag_RequestGlobal_oCAN00, transmitter=TN_0x00E0_Tester:
      ident msg_diag_RequestGlobal_oTN_0x0001_MyECU
    can-tp-connection addressing-format=STANDARD, can-tp-channel=TPCH, data-pdu=msg_diag_Response_MyECU_Tp_oCAN00, flow-control-pdu=msg_diag_Request_MyECU_Tp_oCAN00, receiver=TN_0x00E0_Tester, ta-type=PHYSICAL, tp-sdu=msg_diag_Response_MyECU_oCAN00, transmitter=TN_0x0001_MyECU:
      ident msg_diag_Response_MyECU_oTN_0x0001_MyECU
    can tp node TN_0x0001_MyECU: connector=CN_CAN00, tp-address=TA_0x0001
    can tp node TN_0x00E0_Tester: tp-address=TA_0x00E0
package /Cluster
  can cluster CAN00: baudrate=500000, protocol-name=CAN  # CANFD364 | Boot-only communication matrix: UDS diagnostic frames only (no App/Com/Nm). phys req 0x74C, phys resp 0x75C, func req 0x7DF.
    can physical channel CHNL: comm-connectors=CN_CAN00
      frame msg_diag_Request_MyECU_oCAN00: id 0x74C, to MyECU, frame-length=8, can-addressing-mode=STANDARD  # UDS physical request (ID 0x74C, Tester -> MyECU), 8 bytes classic CAN. CanTp Rx (physical).
        n pdu msg_diag_Request_MyECU_Tp_oCAN00: length=8
      frame msg_diag_RequestGlobal_oCAN00: id 0x7DF, to MyECU, frame-length=8, can-addressing-mode=STANDARD  # UDS functional request (ID 0x7DF, broadcast), 8 bytes classic CAN. CanTp Rx (functional).
        n pdu msg_diag_RequestGlobal_Tp_oCAN00: length=8
      frame msg_diag_Response_MyECU_oCAN00: id 0x75C, from MyECU, frame-length=8, can-addressing-mode=STANDARD  # UDS physical response (ID 0x75C, MyECU -> Tester), 8 bytes classic CAN. CanTp Tx.
        n pdu msg_diag_Response_MyECU_Tp_oCAN00: length=8
      pdu triggering PT_msg_diag_Request_MyECU: pdu=msg_diag_Request_MyECU_oCAN00, to MyECU
      pdu triggering PT_msg_diag_RequestGlobal: pdu=msg_diag_RequestGlobal_oCAN00, to MyECU
      pdu triggering PT_msg_diag_Response_MyECU: pdu=msg_diag_Response_MyECU_oCAN00, from MyECU
package /ECU
  ecu instance MyECU
    can communication controller CT_CAN00
    can communication connector CN_CAN00: comm-controller=CT_CAN00
package /PDU
  dcm i pdu msg_diag_Request_MyECU_oCAN00: length=8, diag-pdu-type=DIAG-REQUEST
  dcm i pdu msg_diag_RequestGlobal_oCAN00: length=8, diag-pdu-type=DIAG-REQUEST
  dcm i pdu msg_diag_Response_MyECU_oCAN00: length=8, diag-pdu-type=DIAG-RESPONSE
