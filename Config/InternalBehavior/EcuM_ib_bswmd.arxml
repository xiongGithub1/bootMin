AUTOSAR XML (schema 00048)
package /MICROSAR
  bsw implementation EcuM_Impl: programming-language=C, sw-version=12.00.00, used-code-generator=DaVinci Configurator, vendor-id=30, ar-release-version=4.00.03
