AUTOSAR XML (schema 00048)
package /AURIX2G/EcucDefs/FlsLoader_ib_bswmd/BswModuleDescriptions
  bsw module description FlsLoader
    bsw internal behavior FlsLoaderBehavior
