AUTOSAR XML (schema 00048)
package /AURIX2G/EcucDefs/Wdg_ib_bswmd/BswModuleDescriptions
  bsw module description Wdg
    bsw internal behavior WdgBehavior
      4 x exclusive area:
        TimerHandling
        ChangeMode
        Trigger
        CpuEndInit
