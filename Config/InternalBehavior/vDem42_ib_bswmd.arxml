AUTOSAR XML (schema 00048)
package /MICROSAR
  bsw implementation vDem42_Impl: programming-language=C, sw-version=2.0.0, vendor-id=30, ar-release-version=4.2.2
