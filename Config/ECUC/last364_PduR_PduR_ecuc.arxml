AUTOSAR XML (schema 00048)
package /ActiveEcuC
  module config PduR: implementation-config-variant=VARIANT-PRE-COMPILE, module-description=PduR_Impl
    PduRGeneral:
      PduRDevErrorDetect = true
      PduRVersionInfoApi = false
      PduRMetaDataSupport = false
      PduRPduCallback = false
      PduRSwitching = false
      PduRSafeBswChecks = false
      PduREnableDeferredTransmission = false
      PduREnableDeferredReception = false
      PduRSupportMulticore = false
      PduRRoutingTypeGateway = false
      PduRSpinlockRetryCounter = 4294967295
      PduRExtendedErrorChecks = false
      PduRGeneration:
        PduROutOfBoundsWriteProtectionStrategy = NONE
        PduROutOfBoundsWriteSanitizer = false
        PduROutOfBoundsReadSanitizer = false
        PduRNumericalDataTypeMinimizationStrategy = WITH_CAST
        PduRReduceConstantData2Define = false
        PduRBoolDataInArrayOfStructStrategy = BITMASKING
        PduRDeduplicateIndirectedData = true
        PduRDataDeduplicationStrategy = WITH_CAST
        PduRReduceBoolDataByNegationThreshold = 2
        PduRReduceBoolDataByNumericalComparisonThreshold = 2
        PduRReduceBoolDataByNumericalRelationThreshold = 2
        PduRReduceBoolDataByNumericalOperandStrategy = WITH_ANY_VALUE
        PduRReduceNumericalDataByOffsetThreshold = 2
        PduRReduceNumericalDataByArraySubtractionThreshold = 2
        PduRReduceDataByStreaming = false
        PduRShortSymbols = false
        PduRInterfacesForDeactivatedData = false
        PduRReferringKeysInComments = false
    PduRRoutingTables: PduRConfigurationId=0
      PduRRoutingTable
        3 x PduRRoutingPath, all with PduRRoutingPathCommunicationType=TRANSPORT_PROTOCOL, PduRMulticoreRoutingPath=false, PduRLockRef=PduRLock_PduRExclusiveArea:
          PduRRoutingPath
            PduRDestPdu:
              PduRDestPduHandleId = 0
              PduRDestPduDirection = TRANSMIT
              PduRDestPduRoutingType = API_FORWARDING
              PduRDestPduDataProcessing = IMMEDIATE
              PduRPduLengthHandlingStrategy = UNUSED
              PduRDestPduCrossPartitionDestination = false
              PduRDestPduRef = msg_diag_Response_MyECU_oCAN00_45311294_Tx
              PduRDestPduPduRBswModulesRef = CanTp
            PduRSrcPdu: PduRSourcePduHandleId=0, PduRSrcPduDirection=TRANSMIT, PduRSrcPduRef=msg_diag_Response_MyECU_oCAN00_45311294_Tx, PduRSrcPduPduRBswModulesRef=Cdd
          PduRRoutingPath_001
            PduRDestPdu_1 (PduRDestPdu):
              PduRDestPduHandleId = 1
              PduRDestPduDirection = RECEIVE
              PduRDestPduRoutingType = API_FORWARDING
              PduRDestPduDataProcessing = IMMEDIATE
              PduRPduLengthHandlingStrategy = UNUSED
              PduRDestPduCrossPartitionDestination = false
              PduRDestPduRef = msg_diag_Request_MyECU_oCAN00_a823f7ba_Rx
              PduRDestPduPduRBswModulesRef = Cdd
            PduRSrcPdu_1 (PduRSrcPdu): PduRSourcePduHandleId=0, PduRSrcPduDirection=RECEIVE, PduRSrcPduRef=msg_diag_Request_MyECU_oCAN00_a823f7ba_Rx, PduRSrcPduPduRBswModulesRef=CanTp
          PduRRoutingPath_002
            PduRDestPdu_2 (PduRDestPdu):
              PduRDestPduHandleId = 0
              PduRDestPduDirection = RECEIVE
              PduRDestPduRoutingType = API_FORWARDING
              PduRDestPduDataProcessing = IMMEDIATE
              PduRPduLengthHandlingStrategy = UNUSED
              PduRDestPduCrossPartitionDestination = false
              PduRDestPduRef = msg_diag_RequestGlobal_oCAN00_38f4a687_Rx
              PduRDestPduPduRBswModulesRef = Cdd
            PduRSrcPdu_2 (PduRSrcPdu): PduRSourcePduHandleId=1, PduRSrcPduDirection=RECEIVE, PduRSrcPduRef=msg_diag_RequestGlobal_oCAN00_38f4a687_Rx, PduRSrcPduPduRBswModulesRef=CanTp
      PduRLock_PduRExclusiveArea (PduRLock)
        PduRExclusiveArea: PduRExclusiveAreaId=0
    CanTp (PduRBswModules):
      PduRCancelReceive = false
      PduRCancelTransmit = false
      PduRChangeParameterRequestApi = false
      PduRCommunicationInterface = false
      PduRLowerModule = true
      PduRTransportProtocol = true
      PduRTriggertransmit = false
      PduRTxConfirmation = false
      PduRUpperModule = false
      PduRUseTag = false
      PduRBswModuleRef = CanTp
    Cdd (PduRBswModules):
      PduRCancelReceive = false
      PduRCancelTransmit = false
      PduRChangeParameterRequestApi = false
      PduRCommunicationInterface = false
      PduRLowerModule = false
      PduRTransportProtocol = true
      PduRTriggertransmit = false
      PduRTxConfirmation = false
      PduRUpperModule = true
      PduRUseTag = false
      PduRBswModuleRef = Cdd
