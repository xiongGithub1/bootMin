AUTOSAR XML (schema 00048)
package /ActiveEcuC
  ecuc value collection ActiveEcuC: ecu-extract=SYSTEM
    ecuc-values:
      MemMap
      vBRS
      vSet
      vBaseEnv
      Det
      McalLib
      EcuC
      CanIf
      Can
      ResourceM
      Dio
      Port
      Mcu
      vLinkGen
      CanTp
      Crc
      FlsLoader
      Cdd
      PduR
      Os
      Wdg
      WdgIf
