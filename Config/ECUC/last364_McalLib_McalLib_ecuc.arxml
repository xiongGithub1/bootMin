AUTOSAR XML (schema 00048)
package /ActiveEcuC
  module config McalLib: implementation-config-variant=VARIANT-PRE-COMPILE, module-description=McalLib_Impl
    McalLibPublishedInformation:
      McalLibMcalAvailableCores = 2
      McalLibDsprCore0StartAddr = 1879048192
      McalLibDsprCore0EndAddr = 1879244799
      McalLibDsprCore1StartAddr = 1610612736
      McalLibDsprCore1EndAddr = 1610809343
      McalLibDsprCore2StartAddr = 0
      McalLibDsprCore2EndAddr = 0
      McalLibDsprCore3StartAddr = 0
      McalLibDsprCore3EndAddr = 0
      McalLibDsprCore4StartAddr = 0
      McalLibDsprCore4EndAddr = 0
      McalLibDsprCore5StartAddr = 0
      McalLibDsprCore5EndAddr = 0
      McalLibPsprCore0StartAddr = 1880096768
      McalLibPsprCore0EndAddr = 1880129535
      McalLibPsprCore1StartAddr = 1611661312
      McalLibPsprCore1EndAddr = 1611694079
      McalLibPsprCore2StartAddr = 0
      McalLibPsprCore2EndAddr = 0
      McalLibPsprCore3StartAddr = 0
      McalLibPsprCore3EndAddr = 0
      McalLibPsprCore4StartAddr = 0
      McalLibPsprCore4EndAddr = 0
      McalLibPsprCore5StartAddr = 0
      McalLibPsprCore5EndAddr = 0
      McalLibBackUpClockFreq = 100
    CommonPublishedInformation:
      ArMajorVersion = 4
      ArMinorVersion = 2
      ArPatchVersion = 2
      SwMajorVersion = 20
      SwMinorVersion = 10
      SwPatchVersion = 0
      ModuleId = 255
      VendorId = 17
      Release = _TRICORE_TC364_TQFP
    McalLibGeneral: McalLibSafetyEnable=false
