AUTOSAR XML (schema 00048)
package /ActiveEcuC
  module config Crc: implementation-config-variant=VARIANT-PRE-COMPILE, module-description=Crc_Impl
    CrcGeneral:
      CrcVersionInfoApi = false
      CrcSafetyEnable = false
      CrcDma8bitApi = false
      CrcDma16bitApi = false
      CrcDma32bitApi = false
      CrcDma32P4bitApi = false
      CrcRuntimeApiMode = CRC_MCAL_SUPERVISOR
      Crc8ReturnErrorValue = 0
      Crc8H2FReturnErrorValue = 0
      Crc16ReturnErrorValue = 0
      Crc16ARCReturnErrorValue = 0
      Crc32ReturnErrorValue = 0
      Crc32P4ReturnErrorValue = 0
      Crc64ReturnErrorValue = 0
      Crc16Mode = CRC_16_HARDWARE
      Crc32Mode = CRC_32_HARDWARE
    CrcPublishedInformation:
      CrcInitialValue16 = 65535
      CrcInitialValue16ARC = 0
      CrcInitialValue8 = 255
      CrcInitialValue8H2F = 255
      CrcInitialValue32 = 4294967295
      CrcInitialValue32P4 = 4294967295
      CrcInitialValue64 = 18446744073709551615
    CommonPublishedInformation:
      ArMajorVersion = 4
      ArMinorVersion = 2
      ArPatchVersion = 2
      SwMajorVersion = 20
      SwMinorVersion = 0
      SwPatchVersion = 2
      ModuleId = 201
      VendorId = 17
      Release = _TRICORE_TC364_TQFP
