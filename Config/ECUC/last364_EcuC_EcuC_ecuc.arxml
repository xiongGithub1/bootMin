AUTOSAR XML (schema 00048)
package /ActiveEcuC
  module config EcuC: implementation-config-variant=VARIANT-PRE-COMPILE, module-description=EcuC_Impl
    EcucGeneral:
      CPUType = CPU32Bit
      SizeOfInt = Size32Bit
      ByteOrder = LITTLE_ENDIAN
      BitOrder = LSB_to_MSB
      AtomicBitAccessInBitfield = false
      AtomicVariableAccess = Atomic32BitAccess
      SizeOfEnum = Size32Bit
      SizeOfROMPointer = Size32Bit
      SizeOfRAMPointer = Size32Bit
      BitFieldDataType = INT
      StructAlignment = Auto
      ArrayAlignment = Align8Bit
      StructInArrayAlignment = Auto
      DummyFunction = false
      DummyStatement = true
      DummyStatementKind = None
      ConditionalGenerating = true
      EcucBswImplementationCodeType = EcuCSourceCode
      EcuCUseStdReturnTypeForRte = false
      PostbuildLoadable: AlignmentFillPattern=255, PBROMStartAddress=0, PBRAMStartAddress=0, PBROMEndAddress=0, PBRAMEndAddress=0
      BswInitialization
        22 x InitFunction:
          Det_Init: Header=Det.h, InitPhase=INIT_ZERO, ConfigType=Det_ConfigType, ConfigPtrClass=DET_INIT_DATA, ConfigPtrName=Det_Config_Ptr, ModuleRef=Det  # /ActiveEcuC/Det PLAIN_TEXT Init function description of Det in UnfilteredViewInInvariantProject (UnfilteredInvariantProjectModelView) .
          Det_InitMemory: Header=Det.h, InitPhase=INIT_MEMORY, ModuleRef=Det  # /ActiveEcuC/Det PLAIN_TEXT InitMemory function description of Det in UnfilteredViewInInvariantProject (UnfilteredInvariantProjectModelView) .
          McalLib_Init: Header=McalLib.h, InitPhase=NO_INIT, ModuleRef=McalLib  # /ActiveEcuC/McalLib PLAIN_TEXT Created McalLib_Init by Extended Init XML Service
          Brs_Init: Header=, InitPhase=NO_INIT, ModuleRef=vBRS  # /ActiveEcuC/vBRS PLAIN_TEXT Automatically generated by BswInitFctConfigurationService.
          vBaseEnv_Init: Header=, InitPhase=NO_INIT, ModuleRef=vBaseEnv  # /ActiveEcuC/vBaseEnv PLAIN_TEXT Created vBaseEnv_Init by Extended Init XML Service
          Can_InitMemory: Header=Can.h, InitPhase=INIT_MEMORY, ModuleRef=Can  # /ActiveEcuC/Can PLAIN_TEXT InitMemory function description of Can in UnfilteredViewInInvariantProject (UnfilteredInvariantProjectModelView) .
          Can_Init: Header=Can.h, InitPhase=INIT_TWO_DRV, ConfigType=Can_ConfigType, ConfigPtrClass=CAN_INIT_DATA, ConfigPtrName=Can_Config_Ptr, ModuleRef=Can  # /ActiveEcuC/Can PLAIN_TEXT Init function description of Can in UnfilteredViewInInvariantProject (UnfilteredInvariantProjectModelView) .
          CanIf_Init: Header=CanIf.h, InitPhase=INIT_TWO_IF, ConfigType=CanIf_ConfigType, ConfigPtrClass=CANIF_INIT_DATA, ConfigPtrName=CanIf_Config_Ptr, ModuleRef=CanIf  # /ActiveEcuC/CanIf PLAIN_TEXT Init function description of CanIf in UnfilteredViewInInvariantProject (UnfilteredInvariantProjectModelView) .
          CanIf_InitMemory: Header=CanIf.h, InitPhase=INIT_MEMORY, ModuleRef=CanIf  # /ActiveEcuC/CanIf PLAIN_TEXT InitMemory function description of CanIf in UnfilteredViewInInvariantProject (UnfilteredInvariantProjectModelView) .
          Dio_Init: Header=Dio.h, InitPhase=NO_INIT, ModuleRef=Dio  # /Dio/Dio PLAIN_TEXT Created Dio_Init by Extended Init XML Service
          Mcu_Init: Header=Mcu.h, InitPhase=INIT_ONE_EARLY, ConfigType=Mcu_ConfigType, ConfigPtrClass=AUTOMATIC, ConfigPtrName=&Mcu_Config, AdditionalInitCode=Mcu_InitClock(0);while (MCU_PLL_LOCKED != Mcu_GetPllStatus());Mcu_DistributePllClock();, ModuleRef=Mcu  # /Mcu/Mcu PLAIN_TEXT Created Mcu_Init by Extended Init XML Service
          Port_Init: Header=Port.h, InitPhase=INIT_ONE_EARLY, ConfigType=Port_ConfigType, ConfigPtrClass=AUTOMATIC, ConfigPtrName=&Port_Config, ModuleRef=Port  # /Port/Port PLAIN_TEXT Created Port_Init by Extended Init XML Service
          ResourceM_Init: Header=ResourceM.h, InitPhase=NO_INIT, ModuleRef=ResourceM  # /ResourceM/ResourceM PLAIN_TEXT Created ResourceM_Init by Extended Init XML Service
          vLinkGen_Init: Header=vLinkGen_Lcfg.h, InitPhase=NO_INIT, ModuleRef=vLinkGen  # /ActiveEcuC/vLinkGen PLAIN_TEXT Dummy initialization of the vLinkGen
          CanTp_Init: Header=CanTp.h, InitPhase=INIT_TWO_TP, ConfigType=CanTp_ConfigType, ConfigPtrClass=CANTP_INIT_DATA, ConfigPtrName=CanTp_Config_Ptr, ModuleRef=CanTp  # /ActiveEcuC/CanTp PLAIN_TEXT Init function description of CanTp in UnfilteredViewInInvariantProject (UnfilteredInvariantProjectModelView) .
          CanTp_InitMemory: Header=CanTp.h, InitPhase=INIT_MEMORY, ModuleRef=CanTp  # /ActiveEcuC/CanTp PLAIN_TEXT InitMemory function description of CanTp in UnfilteredViewInInvariantProject (UnfilteredInvariantProjectModelView) .
          Crc_Init: Header=Crc.h, InitPhase=NO_INIT, ModuleRef=Crc  # /ActiveEcuC/Crc PLAIN_TEXT Created Crc_Init by Extended Init XML Service
          FlsLoader_Init: Header=FlsLoader.h, InitPhase=INIT_ONE, ConfigType=FlsLoader_ConfigType, ConfigPtrClass=AUTOMATIC, ConfigPtrName=NULL_PTR, ModuleRef=FlsLoader  # /ActiveEcuC/FlsLoader PLAIN_TEXT Created FlsLoader_Init by Extended Init XML Service
          PduR_PreInit: Header=PduR.h, InitPhase=INIT_ONE, ConfigType=PduR_PBConfigType, ConfigPtrClass=PDUR_INIT_DATA, ConfigPtrName=PduR_Config_Ptr, ModuleRef=PduR  # /ActiveEcuC/PduR PLAIN_TEXT PreInit function description of PduR in UnfilteredViewInInvariantProject (UnfilteredInvariantProjectModelView) .
          PduR_Init: Header=PduR.h, InitPhase=INIT_TWO_COM, ConfigType=PduR_PBConfigType, ConfigPtrClass=PDUR_INIT_DATA, ConfigPtrName=PduR_Config_Ptr, ModuleRef=PduR  # /ActiveEcuC/PduR PLAIN_TEXT Init function description of PduR in UnfilteredViewInInvariantProject (UnfilteredInvariantProjectModelView) .
          PduR_InitMemory: Header=PduR.h, InitPhase=INIT_MEMORY, ModuleRef=PduR  # /ActiveEcuC/PduR PLAIN_TEXT InitMemory function description of PduR in UnfilteredViewInInvariantProject (UnfilteredInvariantProjectModelView) .
          Wdg_17_Scu_Init: Header=Wdg_17_Scu.h, InitPhase=INIT_ONE, ConfigType=Wdg_17_Scu_ConfigType, ConfigPtrClass=AUTOMATIC, ConfigPtrName=&Wdg_17_Scu_Config_0, ModuleRef=Wdg  # /ActiveEcuC/Wdg PLAIN_TEXT Created Wdg_17_Scu_Init by Extended Init XML Service
    EcucHardware
      EcucCoreDefinition: EcucCoreId=0
    EcucPduCollection: PduIdTypeEnum=UINT8, PduLengthTypeEnum=UINT16
      9 x Pdu, all with PduLength=8, J1939Requestable=false:
        msg_diag_Request_MyECU_Tp_oCAN00_ecbacca2_Rx: DynamicLength=false, SysTPduToFrameMappingRef=msg_diag_Request_MyECU_Tp
        msg_diag_Response_MyECU_oCAN00_f4dcbbcd_Tx: DynamicLength=true
        msg_diag_Request_MyECU_oCAN00_a823f7ba_Rx: DynamicLength=true
        msg_diag_RequestGlobal_oCAN00_25be229e_Rx: DynamicLength=true
        msg_diag_Response_MyECU_oCAN00_45311294_Tx: DynamicLength=true
        msg_diag_Request_MyECU_oCAN00_956934ec_Rx: DynamicLength=true
        msg_diag_Response_MyECU_Tp_oCAN00_0ed9d144_Tx: DynamicLength=false, SysTPduToFrameMappingRef=msg_diag_Response_MyECU_Tp
        msg_diag_RequestGlobal_oCAN00_38f4a687_Rx: DynamicLength=true
        msg_diag_RequestGlobal_Tp_oCAN00_7b1e9193_Rx: DynamicLength=false, SysTPduToFrameMappingRef=msg_diag_RequestGlobal_Tp
