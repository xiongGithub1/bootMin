AUTOSAR XML (schema 00048)
package /ActiveEcuC
  module config Cdd: implementation-config-variant=VARIANT-PRE-COMPILE, module-description=Cdd_Impl
    CddComStackContribution
      CddPduRUpperLayerContribution
        CddPduRUpperLayerRxPdu_74c (CddPduRUpperLayerRxPdu): CddPduRUpperLayerHandleId=0, CddPduRUpperLayerPduRef=msg_diag_Request_MyECU_oCAN00_a823f7ba_Rx
        CddPduRUpperLayerTxPdu_75c (CddPduRUpperLayerTxPdu): CddPduRUpperLayerHandleId=0, CddPduRUpperLayerPduRef=msg_diag_Response_MyECU_oCAN00_45311294_Tx
        CddPduRUpperLayerRxPdu_7df (CddPduRUpperLayerRxPdu): CddPduRUpperLayerHandleId=1, CddPduRUpperLayerPduRef=msg_diag_RequestGlobal_oCAN00_38f4a687_Rx
