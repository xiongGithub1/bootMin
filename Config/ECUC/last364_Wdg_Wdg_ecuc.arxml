AUTOSAR XML (schema 00048)
package /ActiveEcuC
  module config Wdg: implementation-config-variant=VARIANT-POST-BUILD-LOADABLE, module-description=Wdg_Impl
    WdgGeneral:
      WdgDevErrorDetect = false
      WdgSafetyEnable = false
      WdgInitCheckApi = false
      WdgDisableAllowed = false
      WdgIndex = 0
      WdgInitialTimeout = 5
      WdgMaxTimeout = 32
      WdgTriggerTimerSelection = STM_TIMER
      WdgRunArea = ROM
      WdgTriggerLocation = NULL_PTR
      WdgInitApiMode = WDG_MCAL_SUPERVISOR
      WdgRuntimeApiMode = WDG_MCAL_SUPERVISOR
      WdgVersionInfoApi = false
    WdgSettingsConfig:
      WdgCoreId = 0
      WdgCPUDisableAllowed = false
      WdgCPUInitialTimeout = 5
      WdgCPUMaxTimeout = 32
      WdgCPUInitialPassword = 60
      WdgDefaultMode = WDGIF_SLOW_MODE
      WdgSystemClockRef = McuClockReferencePointConfig
      WdgSettingsFast: WdgFastModeTimeoutValue=0.01
      WdgSettingsSlow: WdgSlowModeTimeoutValue=0.02
      WdgSettingsOff
      WdgTriggerTimerSetting: WdgSlowRefreshTime=0.015, WdgFastRefreshTime=0.007
    WdgPublishedInformation: WdgTriggerMode=WDG_WINDOW
    CommonPublishedInformation:
      ArMajorVersion = 4
      ArMinorVersion = 2
      ArPatchVersion = 2
      SwMajorVersion = 20
      SwMinorVersion = 10
      SwPatchVersion = 0
      ModuleId = 102
      VendorId = 17
      Release = _TRICORE_TC364_TQFP
      VendorApiInfix = Scu
