AUTOSAR XML (schema 00048)
package /ActiveEcuC
  module config vSet: implementation-config-variant=VARIANT-PRE-COMPILE, module-description=vSet_Impl
    vSetGeneral: vSetDummyStatementKind=None
    vSetPlatform:
      vSetSizeOfRAMPointer = Size32Bit
      vSetCPUType = CPU32Bit
      vSetByteOrder = LITTLE_ENDIAN
      vSetSizeOfEnum = Size32Bit
      vSetSizeOfInt = Size32Bit
      vSetBitOrder = LSB_to_MSB
      vSetSizeOfROMPointer = Size32Bit
    vSetCalibration
    vSetBswInitialization
      30 x vSetInitFunction:
        Det_Init: vSetHeader=Det.h, vSetConfigType=Det_ConfigType, vSetConfigPtrClass=DET_INIT_DATA, vSetModuleRef=Det  # /ActiveEcuC/Det PLAIN_TEXT Init function description of Det in UnfilteredViewInInvariantProject (UnfilteredInvariantProjectModelView) .
          vSetInitFunctionInstance: vSetInitPhase=INIT_ZERO, vSetConfigPtrName=Det_Config_Ptr
        Det_InitMemory: vSetHeader=Det.h, vSetModuleRef=Det  # /ActiveEcuC/Det PLAIN_TEXT InitMemory function description of Det in UnfilteredViewInInvariantProject (UnfilteredInvariantProjectModelView) .
          vSetInitFunctionInstance: vSetInitPhase=INIT_MEMORY
        Brs_Init: vSetHeader=, vSetModuleRef=vBRS  # /ActiveEcuC/vBRS PLAIN_TEXT Automatically generated by BswInitFctConfigurationService.
          vSetInitFunctionInstance: vSetInitPhase=NO_INIT
        vBaseEnv_Init: vSetHeader=, vSetModuleRef=vBaseEnv  # /ActiveEcuC/vBaseEnv PLAIN_TEXT Created vBaseEnv_Init by Extended Init XML Service
          vSetInitFunctionInstance: vSetInitPhase=NO_INIT
        McalLib_Init: vSetHeader=McalLib.h, vSetModuleRef=McalLib  # /ActiveEcuC/McalLib PLAIN_TEXT Created McalLib_Init by Extended Init XML Service
          vSetInitFunctionInstance: vSetInitPhase=NO_INIT
        CanIf_InitMemory: vSetHeader=CanIf.h, vSetModuleRef=CanIf  # /ActiveEcuC/CanIf PLAIN_TEXT InitMemory function description of CanIf in UnfilteredViewInInvariantProject (UnfilteredInvariantProjectModelView) .
          vSetInitFunctionInstance: vSetInitPhase=INIT_MEMORY
        CanIf_Init: vSetHeader=CanIf.h, vSetConfigType=CanIf_ConfigType, vSetConfigPtrClass=CANIF_INIT_DATA, vSetModuleRef=CanIf  # /ActiveEcuC/CanIf PLAIN_TEXT Init function description of CanIf in UnfilteredViewInInvariantProject (UnfilteredInvariantProjectModelView) .
          vSetInitFunctionInstance: vSetInitPhase=INIT_TWO_IF, vSetConfigPtrName=CanIf_Config_Ptr
        CanNm_InitMemory: vSetHeader=CanNm.h, vSetModuleRef=CanNm  # /ActiveEcuC/CanNm PLAIN_TEXT InitMemory function description of CanNm in UnfilteredViewInInvariantProject (UnfilteredInvariantProjectModelView) .
          vSetInitFunctionInstance: vSetInitPhase=INIT_MEMORY
        CanNm_Init: vSetHeader=CanNm.h, vSetConfigType=CanNm_ConfigType, vSetConfigPtrClass=CANNM_INIT_DATA, vSetModuleRef=CanNm  # /ActiveEcuC/CanNm PLAIN_TEXT Init function description of CanNm in UnfilteredViewInInvariantProject (UnfilteredInvariantProjectModelView) .
          vSetInitFunctionInstance: vSetInitPhase=INIT_TWO_NM, vSetConfigPtrName=CanNm_Config_Ptr
        Can_InitMemory: vSetHeader=Can.h, vSetModuleRef=Can  # /ActiveEcuC/Can PLAIN_TEXT InitMemory function description of Can in UnfilteredViewInInvariantProject (UnfilteredInvariantProjectModelView) .
          vSetInitFunctionInstance: vSetInitPhase=INIT_MEMORY
        Can_Init: vSetHeader=Can.h, vSetConfigType=Can_ConfigType, vSetConfigPtrClass=CAN_INIT_DATA, vSetModuleRef=Can  # /ActiveEcuC/Can PLAIN_TEXT Init function description of Can in UnfilteredViewInInvariantProject (UnfilteredInvariantProjectModelView) .
          vSetInitFunctionInstance: vSetInitPhase=INIT_TWO_DRV, vSetConfigPtrName=Can_Config_Ptr
        Nm_Init: vSetHeader=Nm.h, vSetConfigType=Nm_ConfigType, vSetConfigPtrClass=NM_INIT_DATA, vSetModuleRef=Nm  # /ActiveEcuC/Nm PLAIN_TEXT Init function description of Nm in UnfilteredViewInInvariantProject (UnfilteredInvariantProjectModelView) .
          vSetInitFunctionInstance: vSetInitPhase=INIT_TWO_NM, vSetConfigPtrName=Nm_Config_Ptr
        Nm_InitMemory: vSetHeader=Nm.h, vSetModuleRef=Nm  # /ActiveEcuC/Nm PLAIN_TEXT InitMemory function description of Nm in UnfilteredViewInInvariantProject (UnfilteredInvariantProjectModelView) .
          vSetInitFunctionInstance: vSetInitPhase=INIT_MEMORY
        Nm_PreInit: vSetHeader=Nm.h, vSetConfigType=Nm_ConfigType, vSetConfigPtrClass=NM_INIT_DATA, vSetModuleRef=Nm  # /ActiveEcuC/Nm PLAIN_TEXT PreInit function description of Nm in UnfilteredViewInInvariantProject (UnfilteredInvariantProjectModelView) .
          vSetInitFunctionInstance: vSetInitPhase=INIT_ONE, vSetConfigPtrName=Nm_Config_Ptr
        Nm_PostInit: vSetHeader=Nm.h, vSetModuleRef=Nm  # /ActiveEcuC/Nm PLAIN_TEXT Post-Initialization of the Network Management and its internal state machine
          vSetInitFunctionInstance: vSetInitPhase=INIT_THREE
        CanTrcv_30_Tja1145_InitMemory: vSetHeader=CanTrcv_30_Tja1145.h, vSetModuleRef=CanTrcv  # /ActiveEcuC/CanTrcv PLAIN_TEXT InitMemory function description of CanTrcv_30_Tja1145 in UnfilteredViewInInvariantProject (UnfilteredInvariantProjectModelView) .
          vSetInitFunctionInstance: vSetInitPhase=INIT_MEMORY
        CanTrcv_30_Tja1145_Init: vSetHeader=CanTrcv_30_Tja1145.h, vSetConfigType=CanTrcv_30_Tja1145_ConfigType, vSetConfigPtrClass=CANTRCV_30_TJA1145_INIT_DATA, vSetModuleRef=CanTrcv  # /ActiveEcuC/CanTrcv PLAIN_TEXT Init function description of CanTrcv_30_Tja1145 in UnfilteredViewInInvariantProject (UnfilteredInvariantProjectModelView) .
          vSetInitFunctionInstance: vSetInitPhase=INIT_TWO_TRCV, vSetConfigPtrName=CanTrcv_30_Tja1145_Config_Ptr
        Dio_Init: vSetHeader=Dio.h, vSetModuleRef=Dio  # /Dio/Dio PLAIN_TEXT Created Dio_Init by Extended Init XML Service
          vSetInitFunctionInstance: vSetInitPhase=NO_INIT
        Mcu_Init: vSetHeader=Mcu.h, vSetConfigType=Mcu_ConfigType, vSetConfigPtrClass=AUTOMATIC, vSetModuleRef=Mcu  # /Mcu/Mcu PLAIN_TEXT Created Mcu_Init by Extended Init XML Service
          vSetInitFunctionInstance:
            vSetInitPhase = INIT_ONE_EARLY
            vSetConfigPtrName = &Mcu_Config
            vSetAdditionalInitCode = Mcu_InitClock(0);while (MCU_PLL_LOCKED != Mcu_GetPllStatus());Mcu_DistributePllClock();
        Port_Init: vSetHeader=Port.h, vSetConfigType=Port_ConfigType, vSetConfigPtrClass=AUTOMATIC, vSetModuleRef=Port  # /Port/Port PLAIN_TEXT Created Port_Init by Extended Init XML Service
          vSetInitFunctionInstance: vSetInitPhase=INIT_ONE_EARLY, vSetConfigPtrName=&Port_Config
        ResourceM_Init: vSetHeader=ResourceM.h, vSetModuleRef=ResourceM  # /ResourceM/ResourceM PLAIN_TEXT Created ResourceM_Init by Extended Init XML Service
          vSetInitFunctionInstance: vSetInitPhase=NO_INIT
        vLinkGen_Init: vSetHeader=vLinkGen_Lcfg.h, vSetModuleRef=vLinkGen  # /ActiveEcuC/vLinkGen PLAIN_TEXT Dummy initialization of the vLinkGen
          vSetInitFunctionInstance: vSetInitPhase=NO_INIT
        CanTp_InitMemory: vSetHeader=CanTp.h, vSetModuleRef=CanTp  # /ActiveEcuC/CanTp PLAIN_TEXT InitMemory function description of CanTp in UnfilteredViewInInvariantProject (UnfilteredInvariantProjectModelView) .
          vSetInitFunctionInstance: vSetInitPhase=INIT_MEMORY
        CanTp_Init: vSetHeader=CanTp.h, vSetConfigType=CanTp_ConfigType, vSetConfigPtrClass=CANTP_INIT_DATA, vSetModuleRef=CanTp  # /ActiveEcuC/CanTp PLAIN_TEXT Init function description of CanTp in UnfilteredViewInInvariantProject (UnfilteredInvariantProjectModelView) .
          vSetInitFunctionInstance: vSetInitPhase=INIT_TWO_TP, vSetConfigPtrName=CanTp_Config_Ptr
        Crc_Init: vSetHeader=Crc.h, vSetModuleRef=Crc  # /ActiveEcuC/Crc PLAIN_TEXT Created Crc_Init by Extended Init XML Service
          vSetInitFunctionInstance: vSetInitPhase=NO_INIT
        FlsLoader_Init: vSetHeader=FlsLoader.h, vSetConfigType=FlsLoader_ConfigType, vSetConfigPtrClass=AUTOMATIC, vSetModuleRef=FlsLoader  # /ActiveEcuC/FlsLoader PLAIN_TEXT Created FlsLoader_Init by Extended Init XML Service
          vSetInitFunctionInstance: vSetInitPhase=INIT_ONE, vSetConfigPtrName=NULL_PTR
        PduR_Init: vSetHeader=PduR.h, vSetConfigType=PduR_PBConfigType, vSetConfigPtrClass=PDUR_INIT_DATA, vSetModuleRef=PduR  # /ActiveEcuC/PduR PLAIN_TEXT Init function description of PduR in UnfilteredViewInInvariantProject (UnfilteredInvariantProjectModelView) .
          vSetInitFunctionInstance: vSetInitPhase=INIT_TWO_COM, vSetConfigPtrName=PduR_Config_Ptr
        PduR_InitMemory: vSetHeader=PduR.h, vSetModuleRef=PduR  # /ActiveEcuC/PduR PLAIN_TEXT InitMemory function description of PduR in UnfilteredViewInInvariantProject (UnfilteredInvariantProjectModelView) .
          vSetInitFunctionInstance: vSetInitPhase=INIT_MEMORY
        PduR_PreInit: vSetHeader=PduR.h, vSetConfigType=PduR_PBConfigType, vSetConfigPtrClass=PDUR_INIT_DATA, vSetModuleRef=PduR  # /ActiveEcuC/PduR PLAIN_TEXT PreInit function description of PduR in UnfilteredViewInInvariantProject (UnfilteredInvariantProjectModelView) .
          vSetInitFunctionInstance: vSetInitPhase=INIT_ONE, vSetConfigPtrName=PduR_Config_Ptr
        Wdg_17_Scu_Init: vSetHeader=Wdg_17_Scu.h, vSetConfigType=Wdg_17_Scu_ConfigType, vSetConfigPtrClass=AUTOMATIC, vSetModuleRef=Wdg  # /ActiveEcuC/Wdg PLAIN_TEXT Created Wdg_17_Scu_Init by Extended Init XML Service
          vSetInitFunctionInstance: vSetInitPhase=INIT_ONE, vSetConfigPtrName=&Wdg_17_Scu_Config_0
