AUTOSAR XML (schema 00048)
package /ActiveEcuC
  module config FlsLoader: implementation-config-variant=VARIANT-PRE-COMPILE, module-description=FlsLoader_Impl
    FlsLoaderGeneral: FlsLoaderDevErrorDetect=false, FlsLoaderEnableLockCheck=false, FlsLoaderCallOutFunction=NULL_PTR, FlsLoaderCallOutTime=5000000
    FlsLoaderOptionalApi: FlsLoaderDeInitApi=true, FlsLoaderLockUnlockApi=true, FlsLoaderVersionInfoApi=false
    FlsLoaderPFLASHConfig_0 (FlsLoaderPFLASHConfig)
      FlsLoaderPFlash0ProtConfig:
        FlsLoaderPFLash0WriteProt = NO_PROTECTION
        FlsLoaderPFUcbPW0_0 = 0
        FlsLoaderPFUcbPW0_1 = 0
        FlsLoaderPFUcbPW1_0 = 0
        FlsLoaderPFUcbPW1_1 = 0
        FlsLoaderPFUcbPW2_0 = 0
        FlsLoaderPFUcbPW2_1 = 0
        FlsLoaderPFUcbPW3_0 = 0
        FlsLoaderPFUcbPW3_1 = 0
        128 x FlsLoaderPF0Sector, all with FlsLoaderPFSectorWriteProtection=NO_PROTECTION:
          FlsLoaderPF0Sector
          FlsLoaderPF0Sector_{1..127}
      FlsLoaderPFlash1ProtConfig: FlsLoaderPFLash1WriteProt=NO_PROTECTION
        128 x FlsLoaderPF1Sector, all with FlsLoaderPFSectorWriteProtection=NO_PROTECTION:
          FlsLoaderPF1Sector
          FlsLoaderPF1Sector_{1..127}
      FlsLoaderPFlash{2..5}ProtConfig: FlsLoaderPFLash{2..5}WriteProt=NO_PROTECTION
    FlsLoaderDFLASHConfig_0 (FlsLoaderDFLASHConfig)
      FlsLoaderDFlash0ProtConfig:
        FlsLoaderDF0Prot = NO_PROTECTION
        FlsLoaderDF0UcbPW0_0 = 0
        FlsLoaderDF0UcbPW0_1 = 0
        FlsLoaderDF0UcbPW1_0 = 0
        FlsLoaderDF0UcbPW1_1 = 0
        FlsLoaderDF0UcbPW2_0 = 0
        FlsLoaderDF0UcbPW2_1 = 0
        FlsLoaderDF0UcbPW3_0 = 0
        FlsLoaderDF0UcbPW3_1 = 0
    CommonPublishedInformation:
      ArMajorVersion = 4
      ArMinorVersion = 2
      ArPatchVersion = 2
      SwMajorVersion = 20
      SwMinorVersion = 0
      SwPatchVersion = 0
      ModuleId = 255
      VendorId = 17
      Release = _TRICORE_TC364_TQFP
