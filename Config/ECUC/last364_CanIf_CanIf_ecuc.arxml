AUTOSAR XML (schema 00048)
package /ActiveEcuC
  module config CanIf: implementation-config-variant=VARIANT-PRE-COMPILE, module-description=CanIf_Impl
    CanIfCtrlDrvCfg_7d254554 (CanIfCtrlDrvCfg): CanIfCtrlDrvTxCancellation=false, CanIfCtrlDrvInitHohConfigRef=CanIfInitHohCfg, CanIfCtrlDrvNameRef=CanGeneral
      CT_CAN00_9df8a959 (CanIfCtrlCfg): CanIfCtrlId=0, CanIfCtrlWakeupSupport=false, CanIfCtrlJ1939DynAddrSupport=DISABLED, CanIfCtrlCanCtrlRef=CT_CAN00_9df8a959
    CanIfDispatchCfg:
      CanIfDispatchUserCtrlBusOffName = Appl_CanIf_ControllerBusOff
      CanIfDispatchUserCtrlBusOffUL = CDD
      CanIfDispatchUserCtrlModeIndicationName = Appl_CanIf_ControllerModeIndicat
      CanIfDispatchUserCtrlModeIndicationUL = CDD
    CanIfInitCfg
      CHNL_0fb271d2 (CanIfBufferCfg):
        CanIfBufferSize = 1
        CanIfTxBufferHandlingType = PRIO_BY_CANID
        CanIfTxBufferMappedTxPdus = 1
        CanIfTxBufferMaxPduLength = 8
        CanIfBufferHthRef = CN_CAN00_5e566ad9_Tx
      CanIfInitHohCfg: CanIfInitRefCfgSet=CanConfigSet
        CN_CAN00_5e566ad9_Tx (CanIfHthCfg): CanIfHthCanCtrlIdRef=CT_CAN00_9df8a959, CanIfHthIdSymRef=CN_CAN00_5e566ad9_Tx
        CN_CAN00_770af0b0_Rx (CanIfHrhCfg): CanIfHrhSoftwareFilter=true, CanIfHrhCanCtrlIdRef=CT_CAN00_9df8a959, CanIfHrhIdSymRef=CN_CAN00_770af0b0_Rx
      msg_diag_Response_MyECU_Tp_oCAN00_59e48f7a_Tx (CanIfTxPduCfg):
        CanIfTxPduCanId = 1884
        CanIfTxPduCanIdType = STANDARD_CAN
        CanIfTxPduDlc = 8
        CanIfTxPduUserTxConfirmationName = CanTp_TxConfirmation
        CanIfTxPduUserTxConfirmationUL = CAN_TP
        CanIfTxPduId = 0
        CanIfTxPduReadNotifyStatus = false
        CanIfTxPduType = STATIC
        CanIfTxPduTruncation = true
        CanIfTxPduBufferRef = CHNL_0fb271d2
        CanIfTxPduRef = msg_diag_Response_MyECU_Tp_oCAN00_0ed9d144_Tx
      msg_diag_RequestGlobal_Tp_oCAN00_5c56b065_Rx (CanIfRxPduCfg):
        CanIfRxPduCanId = 2015
        CanIfRxPduCanIdType = STANDARD_CAN
        CanIfRxPduDlc = 8
        CanIfRxPduUserRxIndicationName = CanTp_RxIndication
        CanIfRxPduUserRxIndicationType = PDUID_PDUINFOPTR
        CanIfRxPduUserRxIndicationUL = CAN_TP
        CanIfRxPduId = 0
        CanIfRxPduReadData = false
        CanIfRxPduReadNotifyStatus = false
        CanIfRxPduDlcCheck = true
        CanIfRxPduHrhIdRef = CN_CAN00_770af0b0_Rx
        CanIfRxPduRef = msg_diag_RequestGlobal_Tp_oCAN00_7b1e9193_Rx
      msg_diag_Request_MyECU_Tp_oCAN00_2c5ccddc_Rx (CanIfRxPduCfg):
        CanIfRxPduCanId = 1868
        CanIfRxPduCanIdType = STANDARD_CAN
        CanIfRxPduDlc = 8
        CanIfRxPduUserRxIndicationName = CanTp_RxIndication
        CanIfRxPduUserRxIndicationType = PDUID_PDUINFOPTR
        CanIfRxPduUserRxIndicationUL = CAN_TP
        CanIfRxPduId = 1
        CanIfRxPduReadData = false
        CanIfRxPduReadNotifyStatus = false
        CanIfRxPduDlcCheck = true
        CanIfRxPduHrhIdRef = CN_CAN00_770af0b0_Rx
        CanIfRxPduRef = msg_diag_Request_MyECU_Tp_oCAN00_ecbacca2_Rx
    CanIfPrivateCfg:
      CanIfPrivateSoftwareFilterType = LINEAR
      CanIfPrivateDlcCheck = true
      CanIfSupportTTCAN = false
      CanIfTransceiverMapping = false
      CanIfTransceiverHandling = false
      CanIfSupportExtendedIds = false
      CanIfSupportNmOsek = false
      CanIfTxBufferType = BYTE_QUEUE
      CanIfWakeupSupport = false
      CanIfStaticFdTxBufferSupport = false
      CanIfRxSearchConsiderMsgType = false
      CanIfTxBufferFifoSupport = false
      CanIfSetPduReceptionModeSupport = false
      CanIfCheckWakeupCanRetType = false
      CanIfDataChecksumRxSupport = false
      CanIfDataChecksumTxSupport = false
    CanIfPublicCfg:
      CanIfPublicPnSupport = false
      CanIfPublicCancelTransmitSupport = false
      CanIfPublicDevErrorDetect = true
      CanIfPublicHandleTypeEnum = UINT8
      CanIfPublicMultipleDrvSupport = false
      CanIfPublicNumberOfCanHwUnits = 1
      CanIfPublicReadRxPduDataApi = false
      CanIfPublicReadRxPduNotifyStatusApi = false
      CanIfPublicReadTxPduNotifyStatusApi = false
      CanIfPublicSetDynamicTxIdApi = false
      CanIfPublicTxBuffering = true
      CanIfPublicTxConfirmPollingSupport = false
      CanIfPublicVersionInfoApi = false
      CanIfPublicWakeupCheckValidSupport = false
      CanIfPnWakeupTxPduFilterSupport = false
      CanIfPnTrcvHandlingSupport = false
      CanIfJ1939DynAddrSupport = DISABLED
      CanIfSafeBswChecks = false
      CanIfBusMirroringSupport = false
      CanIfEnableSecurityEventReporting = false
      CanIfSupportCanDrvAsr440 = false
      CanIfSupportMultipartition = false
      CanIfSetBaudrateApi = false
      CanIfPublicCddHeaderFile = Appl_CanIf_Cbk.h
