AUTOSAR XML (schema 00048)
package /Dio
  module config Dio: implementation-config-variant=VARIANT-LINK-TIME, module-description=Dio_Impl
    CommonPublishedInformation:
      ArMajorVersion = 4
      ArMinorVersion = 2
      ArPatchVersion = 2
      ModuleId = 120
      Release = _TRICORE_TC364_TQFP
      SwMajorVersion = 20
      SwMinorVersion = 0
      SwPatchVersion = 1
      VendorId = 17
    DioConfig
      DioPort_P33 (DioPort): DioPortId=33
        DioChannel_led1 (DioChannel): DioChannelId=0
        DioChannel_led2 (DioChannel): DioChannelId=1
      DioPort_P20 (DioPort): DioPortId=20
        3 x DioChannel:
          DioChannel_Can1Nstb: DioChannelId=6
          DioChannel_Can1Nerr: DioChannelId=10
          DioChannel_Can1En: DioChannelId=9
    DioGeneral: DioDevErrorDetect=true, DioFlipChannelApi=true, DioMaskedWritePortApi=true, DioSafetyEnable=false, DioVersionInfoApi=false
